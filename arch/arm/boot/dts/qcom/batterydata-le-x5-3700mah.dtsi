qcom,mtp-3700mah {
	/* #2328536_LeTV_X5_3700mAh_averaged_MasterSlave_Feb22nd2016*/
	qcom,max-voltage-uv = <4400000>;
	qcom,nom-batt-capacity-mah = <3700>;
	qcom,batt-id-kohm = <10>;
	qcom,battery-beta = <3380>;
	qcom,battery-type = "2328536_letv_x5_3700mah_averaged_masterslave_feb22nd2016";
	qcom,chg-rslow-comp-c1 = <4139619>;
	qcom,chg-rslow-comp-c2 = <7128323>;
	qcom,chg-rs-to-rslow = <2262662>;
	qcom,chg-rslow-comp-thr = <0xB5>;
	qcom,checksum = <0x5076>;
	qcom,gui-version = "PMI8996GUI - 1.1.0.0";
	qcom,fg-profile-data = [
		 DF 83 EB 7C
		 32 81 72 77
		 53 83 90 5F
		 21 83 6A 8E
		 FB 81 AD 99
		 D4 B7 3A C3
		 58 18 05 88
		 EC 7D D8 81
		 46 7C 69 83
		 3D 6F 5E 89
		 91 94 2C 82
		 5E 99 D6 B7
		 AB C3 58 10
		 20 0F 3F 53
		 14 70 2F FD
		 D3 42 08 4F
		 D2 41 00 00
		 52 54 47 59
		 4E 56 00 00
		 00 00 00 00
		 00 00 00 00
		 0A 7B EE 72
		 4D 7F B4 73
		 B9 7C 03 70
		 59 75 A3 79
		 B8 6F F1 58
		 AF 51 C7 9A
		 48 44 68 03
		 66 A0 71 0C
		 28 00 FF 36
		 F0 11 30 03
		 00 00 00 0C
	];
};
