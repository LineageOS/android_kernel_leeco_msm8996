&soc {
	i2c@75ba000 {
		focaltech@38{
			compatible = "focaltech,fts";
			reg = <0x38>;
			interrupt-parent = <&tlmm>;
			interrupts = <125 0x8>;
/*			vdd-supply = <&pm8994_l22>;*/
			vcc_i2c-supply = <&pm8994_l14>;
			pinctrl-names = "pmx_ts_active", "pmx_ts_suspend";
			pinctrl-0 = <&focaltech_irq_active &focaltech_reset_active>;
			pinctrl-1 = <&focaltech_irq_suspend &focaltech_reset_suspend>;
			focaltech,reset-gpio = <&tlmm 89 0>;
			focaltech,irq-gpio = <&tlmm 125 0>;

			focaltech,name = "fts";
			focaltech,family-id = <0x54>;
			focaltech,display-coords = <0 0 1080 1920>;
			focaltech,panel-coords = <0 0 1080 1920>;
			focaltech,keymap-num = <3>;
			focaltech,keymap-value = <580 172 158>;
			focaltech,keymap-range = <180 1960 10 10
									  360 1960 10 10
									  540 1960 10 10>;
			focaltech,no-force-update;
			focaltech,i2c-pull-up;
			focaltech,group-id = <1>;
			focaltech,hard-reset-delay-ms = <20>;
			focaltech,soft-reset-delay-ms = <250>;
			focaltech,num-max-touches = <10>;
			focaltech,fw-name = "FT_Upgrade_App.i";
			focaltech,fw-delay-aa-ms = <50>;
			focaltech,fw-delay-55-ms = <30>;
			focaltech,fw-upgrade-id1 = <0x79>;
			focaltech,fw-upgrade-id2 = <0x03>;
			focaltech,fw-delay-readid-ms = <10>;
			focaltech,fw-delay-era-flsh-ms = <2000>;
			status = "disabled";

		};
	};
};
