qcom,letv_x2_3200mah {
	qcom,fcc-mah = <3200>;
	qcom,chg-term-ua = <170000>;

	qcom,max-voltage-uv = <4400000>;
	qcom,nom-batt-capacity-mah = <3200>;
	qcom,batt-id-kohm = <10>;
	qcom,battery-beta = <3380>;
	qcom,battery-type = "letv_x2_3200mah";
	qcom,chg-rslow-comp-c1 = <2417907>;
	qcom,chg-rslow-comp-c2 = <3212907>;
	qcom,chg-rs-to-rslow = <889142>;
	qcom,chg-rslow-comp-thr = <0x9F>;
	qcom,checksum = <0xE9E1>;
	qcom,gui-version = "PMI8996GUI - 1.1.0.0";

	qcom,fg-profile-data = [
		D7 83 69 7C
		DA 80 F1 76
		69 83 7B 75
		EF 89 AB 94
		FA 81 CC 99
		0F BC AD C3
		57 13 F0 83
		E1 7C 18 81
		46 77 61 83
		18 66 5E 88
		13 94 21 82
		08 9A 05 BD
		E4 C9 55 0E
		82 0C EB 59
		14 70 8B FD
		1E 3D 45 3C
		00 00 00 00
		23 44 C1 33
		FD 3E 00 00
		00 00 00 00
		00 00 00 00
		22 70 B2 6B
		81 6B 27 82
		9C 6F 36 62
		09 39 DD 79
		C0 6E B6 60
		D9 81 1B C2
		0C FF 61 21
		64 A0 71 0C
		28 00 FF 36
		F0 11 30 03
		00 00 00 0C
	];
};
