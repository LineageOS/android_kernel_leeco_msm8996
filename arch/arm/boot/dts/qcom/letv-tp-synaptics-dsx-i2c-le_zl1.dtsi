/*
 * Synaptics DSX touchscreen driver
 *
 * Copyright (C) 2012-2015 Synaptics Incorporated. All rights reserved.
 *
 * Copyright (C) 2012 Alexandra Chin <alexandra.chin@tw.synaptics.com>
 * Copyright (C) 2012 Scott Lin <scott.lin@tw.synaptics.com>
 *
 * This program is free software; you can redistribute it and/or modify
 * it under the terms of the GNU General Public License as published by
 * the Free Software Foundation; either version 2 of the License, or
 * (at your option) any later version.
 *
 * This program is distributed in the hope that it will be useful,
 * but WITHOUT ANY WARRANTY; without even the implied warranty of
 * MERCHANTABILITY or FITNESS FOR A PARTICULAR PURPOSE. See the
 * GNU General Public License for more details.
 *
 * INFORMATION CONTAINED IN THIS DOCUMENT IS PROVIDED "AS-IS," AND SYNAPTICS
 * EXPRESSLY DISCLAIMS ALL EXPRESS AND IMPLIED WARRANTIES, INCLUDING ANY
 * IMPLIED WARRANTIES OF MERCHANTABILITY AND FITNESS FOR A PARTICULAR PURPOSE,
 * AND ANY WARRANTIES OF NON-INFRINGEMENT OF ANY INTELLECTUAL PROPERTY RIGHTS.
 * IN NO EVENT SHALL SYNAPTICS BE LIABLE FOR ANY DIRECT, INDIRECT, INCIDENTAL,
 * SPECIAL, PUNITIVE, OR CONSEQUENTIAL DAMAGES ARISING OUT OF OR IN CONNECTION
 * WITH THE USE OF THE INFORMATION CONTAINED IN THIS DOCUMENT, HOWEVER CAUSED
 * AND BASED ON ANY THEORY OF LIABILITY, WHETHER IN AN ACTION OF CONTRACT,
 * NEGLIGENCE OR OTHER TORTIOUS ACTION, AND EVEN IF SYNAPTICS WAS ADVISED OF
 * THE POSSIBILITY OF SUCH DAMAGE. IF A TRIBUNAL OF COMPETENT JURISDICTION DOES
 * NOT PERMIT THE DISCLAIMER OF DIRECT DAMAGES OR ANY OTHER DAMAGES, SYNAPTICS'
 * TOTAL CUMULATIVE LIABILITY TO ANY PARTY SHALL NOT EXCEED ONE HUNDRED U.S.
 * DOLLARS.
 */

&soc {
	i2c@75ba000{
		#address-cells = <1>;
		#size-cells = <0>;
		synaptics_dsx@20{
			compatible = "synaptics,dsx-i2c";
			reg = <0x20>;
			interrupt-parent = <&tlmm>;
			interrupts = <125 0x2008>;
			pinctrl-names = "pmx_ts_active","pmx_ts_suspend";
			pinctrl-0 = <&synaptics_irq_active &synaptics_reset_active>;
			pinctrl-1 = <&synaptics_irq_suspend &synaptics_reset_suspend>;
			vdd_ana-supply = <&pm8994_l22>;
			vcc_i2c-supply = <&pm8994_l14>;
			synaptics,pwr-reg-name = "vdd_ana";
			synaptics,bus-reg-name = "vcc_i2c";
			synaptics,reset-gpio = <&tlmm 89 0x00>;
			synaptics,irq-gpio = <&tlmm 125 0x2008>;
			synaptics,irq-on-state = <0>;
			synaptics,irq-flags = <0x2008>; /* IRQF_ONESHOT | IRQF_TRIGGER_LOW */
			synaptics,power-delay-ms = <200>;
			synaptics,reset-delay-ms = <200>;
			synaptics,reset-on-state = <0>;
			synaptics,reset-active-ms = <20>;
			synaptics,disable-gpios;
			/* Underlying clocks used by secure touch */
			synaptics,cap-button-codes = <580 172 158>;
			synaptics,driver-line-num = <31>;
			synaptics,sense-line-num = <20>;
			synaptics,capacitance-max-value = <
                            2987  2828  2789  2817  2863  2624  2612  2601  2589  2606  2592  2582  2616  2933  2873  2884  3039  0     0     0
                            2960  2805  2766  2793  2838  2600  2589  2577  2567  2583  2568  2558  2591  2909  2850  2861  3012  0     0     0
                            2965  2811  2772  2799  2845  2606  2594  2584  2573  2590  2575  2565  2598  2915  2857  2868  3018  0     0     0
                            2970  2814  2776  2804  2849  2610  2600  2589  2578  2595  2580  2570  2602  2920  2859  2872  3021  0     0     0
                            2975  2818  2779  2808  2854  2615  2603  2594  2582  2599  2584  2574  2608  2925  2865  2876  3025  0     0     0
                            2981  2826  2788  2815  2862  2623  2612  2602  2592  2608  2593  2584  2617  2933  2874  2884  3033  0     0     0
                            2984  2829  2791  2820  2867  2628  2617  2608  2597  2613  2599  2588  2621  2937  2878  2888  3037  0     0     0
                            2990  2836  2798  2827  2874  2634  2624  2614  2605  2620  2606  2597  2630  2945  2885  2895  3044  0     0     0
                            2996  2842  2805  2834  2882  2644  2633  2623  2614  2629  2615  2605  2637  2951  2891  2901  3049  0     0     0
                            3002  2850  2812  2842  2890  2650  2639  2628  2620  2636  2621  2612  2644  2958  2897  2905  3054  0     0     0
                            3010  2857  2819  2849  2899  2657  2648  2638  2628  2643  2629  2620  2651  2964  2902  2913  3059  0     0     0
                            3018  2865  2828  2859  2910  2668  2657  2648  2638  2653  2640  2631  2663  2974  2912  2921  3065  0     0     0
                            3024  2872  2835  2866  2917  2675  2667  2657  2647  2661  2648  2639  2672  2981  2919  2928  3071  0     0     0
                            3034  2881  2845  2876  2928  2686  2676  2668  2660  2674  2659  2651  2683  2991  2928  2936  3078  0     0     0
                            3040  2889  2853  2886  2939  2696  2687  2678  2670  2683  2670  2662  2694  3001  2936  2945  3085  0     0     0
                            3045  2896  2861  2894  2948  2703  2693  2687  2678  2690  2678  2670  2703  3007  2943  2951  3091  0     0     0
                            3052  2904  2869  2903  2958  2712  2703  2697  2688  2702  2686  2679  2713  3016  2951  2959  3097  0     0     0
                            3058  2913  2877  2912  2968  2723  2714  2707  2699  2712  2697  2691  2724  3025  2960  2968  3104  0     0     0
                            3062  2918  2884  2919  2976  2731  2721  2716  2707  2720  2706  2700  2733  3032  2967  2974  3109  0     0     0
                            3071  2928  2896  2931  2989  2742  2734  2729  2721  2732  2720  2714  2746  3043  2978  2984  3118  0     0     0
                            3076  2936  2903  2940  3000  2752  2744  2739  2731  2742  2730  2724  2756  3053  2986  2991  3123  0     0     0
                            3083  2944  2912  2949  3011  2761  2754  2749  2743  2754  2742  2736  2767  3063  2995  3000  3129  0     0     0
                            3087  2949  2918  2955  3018  2769  2760  2757  2749  2760  2748  2744  2775  3068  3001  3006  3134  0     0     0
                            3092  2956  2925  2963  3026  2777  2768  2766  2759  2769  2757  2754  2785  3075  3008  3012  3139  0     0     0
                            3097  2963  2932  2972  3037  2785  2777  2775  2768  2777  2766  2763  2795  3082  3015  3019  3144  0     0     0
                            3103  2971  2943  2982  3048  2794  2787  2786  2779  2787  2777  2774  2806  3090  3023  3028  3150  0     0     0
                            3107  2977  2949  2989  3056  2803  2795  2794  2787  2795  2785  2783  2815  3096  3029  3032  3154  0     0     0
                            3111  2986  2959  2998  3064  2814  2806  2804  2798  2806  2796  2794  2825  3103  3038  3041  3159  0     0     0
                            3120  2996  2970  3010  3077  2827  2819  2819  2814  2821  2810  2807  2839  3113  3049  3051  3168  0     0     0
                            3201  3102  3065  3104  3168  2926  2919  3006  3101  3062  2968  2920  2950  3212  3174  3186  3255  0     0     0
                            0     0     0     0     0     0     0     0     0     0     0     0     0     0     0     0     0     3217  3243  3438>;
			synaptics,capacitance-min-value = <
		                    1992  1886  1859  1878  1909  1749  1741  1734  1726  1737  1728  1721  1744  1955  1915  1923  2026  0     0     0
		                    1974  1870  1844  1862  1892  1733  1726  1718  1711  1722  1712  1705  1727  1939  1900  1907  2008  0     0     0
		                    1977  1874  1848  1866  1897  1737  1729  1723  1715  1726  1717  1710  1732  1944  1905  1912  2012  0     0     0
		                    1980  1876  1851  1869  1900  1740  1733  1726  1719  1730  1720  1713  1734  1947  1906  1915  2014  0     0     0
		                    1983  1879  1853  1872  1902  1743  1735  1729  1722  1733  1723  1716  1739  1950  1910  1917  2017  0     0     0
		                    1988  1884  1858  1877  1908  1749  1741  1735  1728  1739  1729  1722  1744  1955  1916  1923  2022  0     0     0
		                    1989  1886  1860  1880  1911  1752  1745  1738  1731  1742  1732  1725  1748  1958  1918  1925  2025  0     0     0
		                    1993  1891  1865  1885  1916  1756  1749  1743  1736  1747  1737  1731  1753  1963  1923  1930  2029  0     0     0
		                    1997  1895  1870  1889  1921  1762  1755  1749  1743  1753  1743  1737  1758  1968  1927  1934  2033  0     0     0
		                    2002  1900  1874  1894  1926  1767  1759  1752  1747  1757  1748  1741  1763  1972  1931  1937  2036  0     0     0
		                    2007  1905  1879  1899  1933  1772  1765  1758  1752  1762  1753  1747  1768  1976  1935  1942  2039  0     0     0
		                    2012  1910  1886  1906  1940  1779  1771  1766  1759  1769  1760  1754  1775  1983  1941  1947  2044  0     0     0
		                    2016  1914  1890  1911  1944  1783  1778  1771  1765  1774  1766  1760  1781  1987  1946  1952  2047  0     0     0
		                    2022  1921  1896  1918  1952  1791  1784  1779  1773  1782  1773  1767  1789  1994  1952  1958  2052  0     0     0
		                    2026  1926  1902  1924  1960  1797  1791  1786  1780  1789  1780  1775  1796  2001  1958  1963  2057  0     0     0
		                    2030  1931  1907  1930  1965  1802  1795  1791  1785  1794  1785  1780  1802  2005  1962  1968  2060  0     0     0
		                    2035  1936  1912  1935  1972  1808  1802  1798  1792  1801  1791  1786  1809  2011  1968  1973  2065  0     0     0
		                    2038  1942  1918  1942  1979  1815  1809  1805  1799  1808  1798  1794  1816  2017  1973  1979  2069  0     0     0
		                    2042  1945  1923  1946  1984  1821  1814  1810  1805  1813  1804  1800  1822  2021  1978  1982  2073  0     0     0
		                    2047  1952  1931  1954  1993  1828  1823  1819  1814  1822  1813  1809  1831  2029  1985  1989  2078  0     0     0
		                    2051  1957  1935  1960  2000  1835  1829  1826  1820  1828  1820  1816  1837  2035  1991  1994  2082  0     0     0
		                    2055  1962  1942  1966  2007  1841  1836  1833  1828  1836  1828  1824  1845  2042  1997  2000  2086  0     0     0
		                    2058  1966  1945  1970  2012  1846  1840  1838  1833  1840  1832  1829  1850  2045  2001  2004  2090  0     0     0
		                    2061  1971  1950  1975  2017  1851  1845  1844  1839  1846  1838  1836  1857  2050  2006  2008  2093  0     0     0
		                    2064  1975  1955  1981  2025  1857  1851  1850  1845  1852  1844  1842  1863  2054  2010  2013  2096  0     0     0
		                    2068  1981  1962  1988  2032  1863  1858  1857  1853  1858  1851  1850  1871  2060  2016  2018  2100  0     0     0
		                    2071  1985  1966  1993  2037  1869  1864  1863  1858  1864  1857  1855  1876  2064  2020  2022  2102  0     0     0
		                    2074  1990  1972  1999  2042  1876  1871  1869  1866  1871  1864  1862  1883  2069  2025  2027  2106  0     0     0
		                    2080  1998  1980  2006  2051  1884  1879  1879  1876  1880  1873  1871  1893  2076  2033  2034  2112  0     0     0
		                    2134  2068  2043  2069  2112  1951  1946  2004  2067  2042  1979  1947  1967  2141  2116  2124  2170  0     0     0
		                    0     0     0     0     0     0     0     0     0     0     0     0     0     0     0     0     0     1920  1940  2060>;
		};
	};
};
