/* Copyright (c) 2013-2014, The Linux Foundation. All rights reserved.
 *
 * This program is free software; you can redistribute it and/or modify
 * it under the terms of the GNU General Public License version 2 and
 * only version 2 as published by the Free Software Foundation.
 *
 * This program is distributed in the hope that it will be useful,
 * but WITHOUT ANY WARRANTY; without even the implied warranty of
 * MERCHANTABILITY or FITNESS FOR A PARTICULAR PURPOSE.  See the
 * GNU General Public License for more details.
 */

&mdss_mdp {
	dsi_dualdsi_truly_cmd: qcom,mdss_dsi_truly_qhd_dualdsi_cmd_le_x2 {
		qcom,mdss-dsi-panel-name = "le_x2_mdss_dsi_sharp_qhd_dualdsi_cmd";
		qcom,mdss-dsi-panel-type = "dsi_cmd_mode";
		qcom,mdss-dsi-panel-framerate = <60>;
		qcom,mdss-dsi-virtual-channel-id = <0>;
		qcom,mdss-dsi-stream = <0>;
		qcom,mdss-dsi-panel-width = <720>;
		qcom,mdss-dsi-panel-height = <2560>;
		qcom,mdss-pan-physical-width-dimension = <71>;
		qcom,mdss-pan-physical-height-dimension = <126>;
		qcom,mdss-dsi-h-front-porch = <80>;
		qcom,mdss-dsi-h-back-porch = <60>;
		qcom,mdss-dsi-h-pulse-width = <10>;
		qcom,mdss-dsi-h-sync-skew = <0>;
		qcom,mdss-dsi-v-back-porch = <7>;
		qcom,mdss-dsi-v-front-porch = <8>;
		qcom,mdss-dsi-v-pulse-width = <1>;
		qcom,mdss-dsi-h-left-border = <0>;
		qcom,mdss-dsi-h-right-border = <0>;
		qcom,mdss-dsi-v-top-border = <0>;
		qcom,mdss-dsi-v-bottom-border = <0>;
		qcom,mdss-dsi-bpp = <24>;
		qcom,mdss-dsi-color-order = "rgb_swap_rgb";
		qcom,mdss-dsi-underflow-color = <0xff>;
		qcom,mdss-dsi-border-color = <0>;
		qcom,mdss-dsi-h-sync-pulse = <0>;
		qcom,mdss-dsi-traffic-mode = "non_burst_sync_event";
		qcom,mdss-dsi-bllp-eof-power-mode;
		qcom,mdss-dsi-bllp-power-mode;
		qcom,mdss-dsi-lane-0-state;
		qcom,mdss-dsi-lane-1-state;
		qcom,mdss-dsi-lane-2-state;
		qcom,mdss-dsi-lane-3-state;
		qcom,mdss-dsi-panel-timings = [cd 32 22 00 60 64 26 34 29 03
									04 00];
		qcom,mdss-dsi-bl-pmic-control-type = "bl_ctrl_wled";
		qcom,mdss-dsi-bl-min-level = <1>;
		qcom,cont-splash-enabled;
		qcom,panel-supply-entries = <&dsi_panel_pwr_supply>;
		qcom,mdss-dsi-panel-timings-8996 = [23 1e 07 08 05 03 04 a0
						23 1e 07 08 05 03 04 a0
						23 1e 07 08 05 03 04 a0
						23 1e 07 08 05 03 04 a0
						23 18 07 08 05 03 04 a0];
		qcom,mdss-dsi-reset-sequence = <1 10>, <0 10>, <1 10>;
		qcom,mdss-dsi-t-clk-post = <0x03>;
		qcom,mdss-dsi-t-clk-pre = <0x2d>;
		qcom,mdss-mdp-transfer-time-us = <10000>;
		qcom,mdss-dsi-bl-max-level = <4095>;
		qcom,mdss-brightness-max-level = <4095>;
		qcom,mdss-dsi-dma-trigger = "trigger_sw";
		qcom,mdss-dsi-mdp-trigger = "none";
		qcom,mdss-dsi-te-pin-select = <1>;
		qcom,mdss-dsi-wr-mem-start = <0x2c>;
		qcom,mdss-dsi-wr-mem-continue = <0x3c>;
		qcom,mdss-dsi-te-dcs-command = <1>;
		qcom,mdss-dsi-te-check-enable;
		qcom,mdss-dsi-te-using-te-pin;
		qcom,ulps-enabled;
		qcom,dcs-cmd-by-left;
		qcom,config-select = <&dsi_truly_qhd_dualdsi_cmd_le_x2_config0>;
		qcom,mdss-dsi-on-command = [
15 01 00 00 00 00 02 FF 20
15 01 00 00 00 00 02 FB 01
15 01 00 00 00 00 02 00 01
15 01 00 00 00 00 02 01 33
15 01 00 00 00 00 02 02 45
15 01 00 00 00 00 02 04 10
15 01 00 00 00 00 02 05 50
15 01 00 00 00 00 02 06 98
15 01 00 00 00 00 02 07 9A
15 01 00 00 00 00 02 08 08
15 01 00 00 00 00 02 09 D7
15 01 00 00 00 00 02 0A D7
15 01 00 00 00 00 02 0B D7
15 01 00 00 00 00 02 0C D7
15 01 00 00 00 00 02 0D 00
15 01 00 00 00 00 02 0E A3
15 01 00 00 00 00 02 0F 9E
15 01 00 00 00 00 02 11 B4
15 01 00 00 00 00 02 12 B4
15 01 00 00 00 00 02 13 00
15 01 00 00 00 00 02 14 0A
15 01 00 00 00 00 02 15 9A
15 01 00 00 00 00 02 16 9A
15 01 00 00 00 00 02 17 B4
15 01 00 00 00 00 02 18 B4
15 01 00 00 00 00 02 19 B4
15 01 00 00 00 00 02 1A B4
15 01 00 00 00 00 02 1C 44
15 01 00 00 00 00 02 1D 44
15 01 00 00 00 00 02 30 6f
15 01 00 00 00 00 02 31 52
15 01 00 00 00 00 02 32 3D
15 01 00 00 00 00 02 44 37
15 01 00 00 00 00 02 45 A9
15 01 00 00 00 00 02 46 82
15 01 00 00 00 00 02 48 A8
15 01 00 00 00 00 02 4E 21
15 01 00 00 00 00 02 4F 43
15 01 00 00 00 00 02 50 65
15 01 00 00 00 00 02 51 87
15 01 00 00 00 00 02 52 A9
15 01 00 00 00 00 02 53 CB
15 01 00 00 00 00 02 54 ED
15 01 00 00 00 00 02 55 1F
15 01 00 00 00 00 02 56 80
15 01 00 00 00 00 02 58 00
15 01 00 00 00 00 02 59 00
15 01 00 00 00 00 02 5A 00
15 01 00 00 00 00 02 5B 00
15 01 00 00 00 00 02 5C 80
15 01 00 00 00 00 02 5D 82
15 01 00 00 00 00 02 5E 00
15 01 00 00 00 00 02 5F 00
15 01 00 00 00 00 02 60 00
15 01 00 00 00 00 02 61 00
15 01 00 00 00 00 02 62 00
15 01 00 00 00 00 02 63 00
15 01 00 00 00 00 02 64 00
15 01 00 00 00 00 02 65 00
15 01 00 00 00 00 02 66 00
15 01 00 00 00 00 02 67 00
15 01 00 00 00 00 02 68 03
15 01 00 00 00 00 02 6B 43
15 01 00 00 00 00 02 6D 33
15 01 00 00 00 00 02 6E 00
15 01 00 00 00 00 02 6F 00
15 01 00 00 00 00 02 71 54
15 01 00 00 00 00 02 72 11
15 01 00 00 00 00 02 74 00     
15 01 00 00 00 00 02 FF 23
15 01 00 00 00 00 02 FB 01
15 01 00 00 00 00 02 07 20
15 01 00 00 00 00 02 45 01
15 01 00 00 00 00 02 46 FF     
15 01 00 00 00 00 02 FF 24
15 01 00 00 00 00 02 FB 01    
15 01 00 00 00 00 02 00 19
15 01 00 00 00 00 02 01 03
15 01 00 00 00 00 02 02 04
15 01 00 00 00 00 02 03 1B
15 01 00 00 00 00 02 04 1D
15 01 00 00 00 00 02 05 01
15 01 00 00 00 00 02 06 0C
15 01 00 00 00 00 02 07 0F
15 01 00 00 00 00 02 08 1F
15 01 00 00 00 00 02 09 00
15 01 00 00 00 00 02 0A 00
15 01 00 00 00 00 02 0B 13
15 01 00 00 00 00 02 0C 16
15 01 00 00 00 00 02 0D 14
15 01 00 00 00 00 02 0E 15
15 01 00 00 00 00 02 0F 00
15 01 00 00 00 00 02 10 19
15 01 00 00 00 00 02 11 03
15 01 00 00 00 00 02 12 04
15 01 00 00 00 00 02 13 1B
15 01 00 00 00 00 02 14 1D
15 01 00 00 00 00 02 15 01
15 01 00 00 00 00 02 16 0C
15 01 00 00 00 00 02 17 0F
15 01 00 00 00 00 02 18 1F
15 01 00 00 00 00 02 19 00
15 01 00 00 00 00 02 1A 00
15 01 00 00 00 00 02 1B 13
15 01 00 00 00 00 02 1C 16
15 01 00 00 00 00 02 1D 14
15 01 00 00 00 00 02 1E 15
15 01 00 00 00 00 02 1F 00    
15 01 00 00 00 00 02 21 01
15 01 00 00 00 00 02 22 10
15 01 00 00 00 00 02 23 28
15 01 00 00 00 00 02 24 28
15 01 00 00 00 00 02 25 5D
15 01 00 00 00 00 02 26 28
15 01 00 00 00 00 02 27 28
15 01 00 00 00 00 02 29 D8
15 01 00 00 00 00 02 2A 15
15 01 00 00 00 00 02 2B 00
15 01 00 00 00 00 02 2D 00
15 01 00 00 00 00 02 2F 02     
15 01 00 00 00 00 02 30 02
15 01 00 00 00 00 02 31 00
15 01 00 00 00 00 02 32 23
15 01 00 00 00 00 02 33 01
15 01 00 00 00 00 02 34 03
15 01 00 00 00 00 02 35 49
15 01 00 00 00 00 02 36 00
15 01 00 00 00 00 02 37 1D
15 01 00 00 00 00 02 38 08
15 01 00 00 00 00 02 39 03
15 01 00 00 00 00 02 3A 49
15 01 00 00 00 00 02 42 01
15 01 00 00 00 00 02 43 8C
15 01 00 00 00 00 02 44 A3
15 01 00 00 00 00 02 48 8C
15 01 00 00 00 00 02 49 A3
15 01 00 00 00 00 02 5B 00
15 01 00 00 00 00 02 5F 4D
15 01 00 00 00 00 02 63 00
15 01 00 00 00 00 02 67 04
15 01 00 00 00 00 02 6E 10
15 01 00 00 00 00 02 72 02
15 01 00 00 00 00 02 73 00
15 01 00 00 00 00 02 74 04
15 01 00 00 00 00 02 75 1B
15 01 00 00 00 00 02 76 05
15 01 00 00 00 00 02 77 01
15 01 00 00 00 00 02 78 00
15 01 00 00 00 00 02 79 00
15 01 00 00 00 00 02 7A 00
15 01 00 00 00 00 02 7B 91
15 01 00 00 00 00 02 7C DA
15 01 00 00 00 00 02 7D 10
15 01 00 00 00 00 02 7E 04
15 01 00 00 00 00 02 7F 1B
15 01 00 00 00 00 02 80 00
15 01 00 00 00 00 02 81 05
15 01 00 00 00 00 02 82 01
15 01 00 00 00 00 02 83 00
15 01 00 00 00 00 02 84 05
15 01 00 00 00 00 02 85 05
15 01 00 00 00 00 02 86 1B
15 01 00 00 00 00 02 87 1B
15 01 00 00 00 00 02 88 1B
15 01 00 00 00 00 02 89 1B
15 01 00 00 00 00 02 8A 00
15 01 00 00 00 00 02 8B F0
15 01 00 00 00 00 02 8C 00
15 01 00 00 00 00 02 8F 63
15 01 00 00 00 00 02 90 51
15 01 00 00 00 00 02 91 40
15 01 00 00 00 00 02 92 51
15 01 00 00 00 00 02 93 08
15 01 00 00 00 00 02 94 08
15 01 00 00 00 00 02 95 51
15 01 00 00 00 00 02 96 51
15 01 00 00 00 00 02 97 00
15 01 00 00 00 00 02 98 00
15 01 00 00 00 00 02 99 33
15 01 00 00 00 00 02 9B FF
15 01 00 00 00 00 02 9C 01
15 01 00 00 00 00 02 9D b0     
15 01 00 00 00 00 02 A5 10
15 01 00 00 00 00 02 A6 01
15 01 00 00 00 00 02 A9 21
15 01 00 00 00 00 02 B3 2A
15 01 00 00 00 00 02 B4 DA
15 01 00 00 00 00 02 BA 83
15 01 00 00 00 00 02 C4 24
15 01 00 00 00 00 02 C5 3A
15 01 00 00 00 00 02 C6 09
15 01 00 00 00 00 02 C7 00
15 01 00 00 00 00 02 C9 C0
15 01 00 00 00 00 02 CA 04
15 01 00 00 00 00 02 D5 3F
15 01 00 00 00 00 02 D6 10
15 01 00 00 00 00 02 D7 3F
15 01 00 00 00 00 02 D8 10
15 01 00 00 00 00 02 D9 EE
15 01 00 00 00 00 02 DA 49
15 01 00 00 00 00 02 DB 94
15 01 00 00 00 00 02 E9 33
15 01 00 00 00 00 02 EB 28
15 01 00 00 00 00 02 EC 00
15 01 00 00 00 00 02 EE 00
15 01 00 00 00 00 02 EF 06
15 01 00 00 00 00 02 F0 01
15 01 00 00 00 00 02 F1 01
15 01 00 00 00 00 02 F2 0D
15 01 00 00 00 00 02 F3 48
15 01 00 00 00 00 02 F6 00
15 01 00 00 00 00 02 F7 00
15 01 00 00 00 00 02 F8 00
15 01 00 00 00 00 02 F9 00          
15 01 00 00 00 00 02 FF 26
15 01 00 00 00 00 02 FB 01
15 01 00 00 00 00 02 00 AB
15 01 00 00 00 00 02 01 00
15 01 00 00 00 00 02 02 80
15 01 00 00 00 00 02 03 08
15 01 00 00 00 00 02 04 01
15 01 00 00 00 00 02 05 32
15 01 00 00 00 00 02 06 4C
15 01 00 00 00 00 02 07 26
15 01 00 00 00 00 02 08 09
15 01 00 00 00 00 02 09 02
15 01 00 00 00 00 02 0A 32
15 01 00 00 00 00 02 0B 55
15 01 00 00 00 00 02 0C 14
15 01 00 00 00 00 02 0D 28
15 01 00 00 00 00 02 0E 00
15 01 00 00 00 00 02 0F 00
15 01 00 00 00 00 02 10 00
15 01 00 00 00 00 02 11 22
15 01 00 00 00 00 02 12 0A
15 01 00 00 00 00 02 13 20
15 01 00 00 00 00 02 14 06
15 01 00 00 00 00 02 15 00
15 01 00 00 00 00 02 16 40
15 01 00 00 00 00 02 19 43
15 01 00 00 00 00 02 1A 03
15 01 00 00 00 00 02 1B 25
15 01 00 00 00 00 02 1C 11
15 01 00 00 00 00 02 1D 00
15 01 00 00 00 00 02 1E 80
15 01 00 00 00 00 02 1F 00
15 01 00 00 00 00 02 20 00
15 01 00 00 00 00 02 21 03
15 01 00 00 00 00 02 22 22
15 01 00 00 00 00 02 23 25
15 01 00 00 00 00 02 24 00
15 01 00 00 00 00 02 25 A7
15 01 00 00 00 00 02 26 00
15 01 00 00 00 00 02 27 A5
15 01 00 00 00 00 02 28 06
15 01 00 00 00 00 02 29 85
15 01 00 00 00 00 02 2A 3f
15 01 00 00 00 00 02 2B 97
15 01 00 00 00 00 02 2F 25
15 01 00 00 00 00 02 30 26
15 01 00 00 00 00 02 31 41
15 01 00 00 00 00 02 32 04
15 01 00 00 00 00 02 33 04
15 01 00 00 00 00 02 34 2B
15 01 00 00 00 00 02 35 00
15 01 00 00 00 00 02 36 00
15 01 00 00 00 00 02 37 C8
15 01 00 00 00 00 02 38 26
15 01 00 00 00 00 02 39 25
15 01 00 00 00 00 02 3A 26
15 01 00 00 00 00 02 3F EB
15 01 00 00 00 00 02 41 21
15 01 00 00 00 00 02 42 03
15 01 00 00 00 00 02 43 00
15 01 00 00 00 00 02 44 11
15 01 00 00 00 00 02 45 00
15 01 00 00 00 00 02 46 00
15 01 00 00 00 00 02 47 00
15 01 00 00 00 00 02 48 00
15 01 00 00 00 00 02 49 03
15 01 00 00 00 00 02 4A 00
15 01 00 00 00 00 02 4B 00
15 01 00 00 00 00 02 4C 01
15 01 00 00 00 00 02 4D 4E
15 01 00 00 00 00 02 4E 01
15 01 00 00 00 00 02 4F 4C
15 01 00 00 00 00 02 50 0D
15 01 00 00 00 00 02 51 0E
15 01 00 00 00 00 02 52 23
15 01 00 00 00 00 02 53 97
15 01 00 00 00 00 02 54 4B
15 01 00 00 00 00 02 55 4C
15 01 00 00 00 00 02 56 20
15 01 00 00 00 00 02 58 04
15 01 00 00 00 00 02 59 04
15 01 00 00 00 00 02 5A 09
15 01 00 00 00 00 02 5B 00
15 01 00 00 00 00 02 5C 00
15 01 00 00 00 00 02 5D C8
15 01 00 00 00 00 02 5E 4C
15 01 00 00 00 00 02 5F 4B
15 01 00 00 00 00 02 60 00
15 01 00 00 00 00 02 80 2B
15 01 00 00 00 00 02 81 43
15 01 00 00 00 00 02 82 03
15 01 00 00 00 00 02 83 25
15 01 00 00 00 00 02 84 11
15 01 00 00 00 00 02 85 00
15 01 00 00 00 00 02 86 80      
15 01 00 00 00 00 02 87 00
15 01 00 00 00 00 02 88 00
15 01 00 00 00 00 02 89 03
15 01 00 00 00 00 02 8A 22
15 01 00 00 00 00 02 8B 25
15 01 00 00 00 00 02 8C 00
15 01 00 00 00 00 02 8D A4
15 01 00 00 00 00 02 8E 00
15 01 00 00 00 00 02 8F A2
15 01 00 00 00 00 02 90 06
15 01 00 00 00 00 02 91 63
15 01 00 00 00 00 02 92 3f
15 01 00 00 00 00 02 93 97
15 01 00 00 00 00 02 94 25
15 01 00 00 00 00 02 95 26
15 01 00 00 00 00 02 96 41
15 01 00 00 00 00 02 97 04
15 01 00 00 00 00 02 98 04
15 01 00 00 00 00 02 99 F0
15 01 00 00 00 00 02 9A 00
15 01 00 00 00 00 02 9B 00
15 01 00 00 00 00 02 9C C8
15 01 00 00 00 00 02 9D 50
15 01 00 00 00 00 02 9E 26
15 01 00 00 00 00 02 9F 25
15 01 00 00 00 00 02 A0 26
15 01 00 00 00 00 02 A2 00
15 01 00 00 00 00 02 A3 33
15 01 00 00 00 00 02 A5 40
15 01 00 00 00 00 02 A6 40
15 01 00 00 00 00 02 AC 91
15 01 00 00 00 00 02 AD 66
15 01 00 00 00 00 02 AE 66
15 01 00 00 00 00 02 B1 40
15 01 00 00 00 00 02 B2 40
15 01 00 00 00 00 02 B4 40
15 01 00 00 00 00 02 B5 40
15 01 00 00 00 00 02 B7 40
15 01 00 00 00 00 02 B8 40
15 01 00 00 00 00 02 BA 22
15 01 00 00 00 00 02 BB 00
15 01 00 00 00 00 02 C2 01
15 01 00 00 00 00 02 C3 01
15 01 00 00 00 00 02 C4 01
15 01 00 00 00 00 02 C5 01
15 01 00 00 00 00 02 C6 01
15 01 00 00 00 00 02 C8 00
15 01 00 00 00 00 02 C9 00
15 01 00 00 00 00 02 CA 00
15 01 00 00 00 00 02 CD 00
15 01 00 00 00 00 02 CE 00
15 01 00 00 00 00 02 D6 04
15 01 00 00 00 00 02 D7 00
15 01 00 00 00 00 02 D8 0D
15 01 00 00 00 00 02 D9 00
15 01 00 00 00 00 02 DA 00
15 01 00 00 00 00 02 DB 00
15 01 00 00 00 00 02 DC 00
15 01 00 00 00 00 02 DD 00
15 01 00 00 00 00 02 DE 00
15 01 00 00 00 00 02 DF 01
15 01 00 00 00 00 02 E0 00
15 01 00 00 00 00 02 E1 00
15 01 00 00 00 00 02 E2 19
15 01 00 00 00 00 02 E3 04
15 01 00 00 00 00 02 E4 00
15 01 00 00 00 00 02 E5 04
15 01 00 00 00 00 02 E6 00
15 01 00 00 00 00 02 E7 12
15 01 00 00 00 00 02 E8 00
15 01 00 00 00 00 02 E9 50
15 01 00 00 00 00 02 EA 10
15 01 00 00 00 00 02 EB 02            
15 01 00 00 00 00 02 FF 27
15 01 00 00 00 00 02 FB 01     
15 01 00 00 00 00 02 02 04
15 01 00 00 00 00 02 12 A0
15 01 00 00 00 00 02 13 60
15 01 00 00 00 00 02 14 23
15 01 00 00 00 00 02 15 00
15 01 00 00 00 00 02 16 23
15 01 00 00 00 00 02 17 00
15 01 00 00 00 00 02 18 23
15 01 00 00 00 00 02 19 00
15 01 00 00 00 00 02 58 12
15 01 00 00 00 00 02 59 12
15 01 00 00 00 00 02 5A 12
15 01 00 00 00 00 02 5B 12
15 01 00 00 00 00 02 5C 12
15 01 00 00 00 00 02 5D 12
15 01 00 00 00 00 02 5E 0F
15 01 00 00 00 00 02 5F 00
15 01 00 00 00 00 02 62 00
15 01 00 00 00 00 02 63 00
15 01 00 00 00 00 02 64 00
15 01 00 00 00 00 02 65 00
15 01 00 00 00 00 02 66 00
15 01 00 00 00 00 02 67 00
15 01 00 00 00 00 02 6C 12
15 01 00 00 00 00 02 6D 12
15 01 00 00 00 00 02 6E 12
15 01 00 00 00 00 02 6F 12
15 01 00 00 00 00 02 70 12
15 01 00 00 00 00 02 71 12
15 01 00 00 00 00 02 72 0F
15 01 00 00 00 00 02 73 00
15 01 00 00 00 00 02 76 00
15 01 00 00 00 00 02 77 00
15 01 00 00 00 00 02 78 00
15 01 00 00 00 00 02 79 00
15 01 00 00 00 00 02 7A 00
15 01 00 00 00 00 02 7B 00
15 01 00 00 00 00 02 80 12
15 01 00 00 00 00 02 81 12
15 01 00 00 00 00 02 82 12
15 01 00 00 00 00 02 83 12
15 01 00 00 00 00 02 84 12
15 01 00 00 00 00 02 85 12
15 01 00 00 00 00 02 86 0F
15 01 00 00 00 00 02 87 00
15 01 00 00 00 00 02 8A 00
15 01 00 00 00 00 02 8B 00
15 01 00 00 00 00 02 8C 00      
15 01 00 00 00 00 02 8D 00
15 01 00 00 00 00 02 8E 00
15 01 00 00 00 00 02 8F 00
15 01 00 00 00 00 02 94 12
15 01 00 00 00 00 02 95 12
15 01 00 00 00 00 02 96 12
15 01 00 00 00 00 02 97 12
15 01 00 00 00 00 02 98 12
15 01 00 00 00 00 02 99 12
15 01 00 00 00 00 02 9A 0F
15 01 00 00 00 00 02 9B 00
15 01 00 00 00 00 02 9E 00
15 01 00 00 00 00 02 9F 00
15 01 00 00 00 00 02 A0 00
15 01 00 00 00 00 02 A2 00
15 01 00 00 00 00 02 A3 00
15 01 00 00 00 00 02 A4 00        
15 01 00 00 00 00 02 FF 28
15 01 00 00 00 00 02 FB 01
15 01 00 00 00 00 02 60 0A
15 01 00 00 00 00 02 63 32
15 01 00 00 00 00 02 64 01
15 01 00 00 00 00 02 68 DA
15 01 00 00 00 00 02 69 00          
15 01 00 00 00 00 02 FF 29
15 01 00 00 00 00 02 FB 01
15 01 00 00 00 00 02 60 0A
15 01 00 00 00 00 02 63 32
15 01 00 00 00 00 02 64 01
15 01 00 00 00 00 02 68 DA
15 01 00 00 00 00 02 69 00          
15 01 00 00 00 00 02 FF E0
15 01 00 00 00 00 02 FB 01
15 01 00 00 00 00 02 35 40
15 01 00 00 00 00 02 36 40
15 01 00 00 00 00 02 37 00
15 01 00 00 00 00 02 89 C6     
15 01 00 00 00 00 02 FF F0
15 01 00 00 00 00 02 FB 01
15 01 00 00 00 00 02 EA 40     
15 01 00 00 00 00 02 FF 20
15 01 00 00 00 00 02 FB 01
15 01 00 00 00 00 02 75 00
15 01 00 00 00 00 02 76 00
15 01 00 00 00 00 02 77 00
15 01 00 00 00 00 02 78 1D
15 01 00 00 00 00 02 79 00
15 01 00 00 00 00 02 7A 51
15 01 00 00 00 00 02 7B 00
15 01 00 00 00 00 02 7C 79
15 01 00 00 00 00 02 7D 00
15 01 00 00 00 00 02 7E 97
15 01 00 00 00 00 02 7F 00
15 01 00 00 00 00 02 80 B1
15 01 00 00 00 00 02 81 00
15 01 00 00 00 00 02 82 C9
15 01 00 00 00 00 02 83 00
15 01 00 00 00 00 02 84 DD
15 01 00 00 00 00 02 85 00
15 01 00 00 00 00 02 86 F0
15 01 00 00 00 00 02 87 01
15 01 00 00 00 00 02 88 2B
15 01 00 00 00 00 02 89 01
15 01 00 00 00 00 02 8A 58
15 01 00 00 00 00 02 8B 01   
15 01 00 00 00 00 02 8C 9A
15 01 00 00 00 00 02 8D 01
15 01 00 00 00 00 02 8E CD
15 01 00 00 00 00 02 8F 02
15 01 00 00 00 00 02 90 15
15 01 00 00 00 00 02 91 02
15 01 00 00 00 00 02 92 4D
15 01 00 00 00 00 02 93 02
15 01 00 00 00 00 02 94 4F
15 01 00 00 00 00 02 95 02
15 01 00 00 00 00 02 96 84
15 01 00 00 00 00 02 97 02
15 01 00 00 00 00 02 98 BD
15 01 00 00 00 00 02 99 02
15 01 00 00 00 00 02 9A E1
15 01 00 00 00 00 02 9B 03
15 01 00 00 00 00 02 9C 12
15 01 00 00 00 00 02 9D 03
15 01 00 00 00 00 02 9E 34
15 01 00 00 00 00 02 9F 03
15 01 00 00 00 00 02 A0 65
15 01 00 00 00 00 02 A2 03
15 01 00 00 00 00 02 A3 74
15 01 00 00 00 00 02 A4 03
15 01 00 00 00 00 02 A5 84
15 01 00 00 00 00 02 A6 03
15 01 00 00 00 00 02 A7 96
15 01 00 00 00 00 02 A9 03
15 01 00 00 00 00 02 AA AA
15 01 00 00 00 00 02 AB 03
15 01 00 00 00 00 02 AC BF
15 01 00 00 00 00 02 AD 03
15 01 00 00 00 00 02 AE D8
15 01 00 00 00 00 02 AF 03
15 01 00 00 00 00 02 B0 F2
15 01 00 00 00 00 02 B1 03
15 01 00 00 00 00 02 B2 FF     
15 01 00 00 00 00 02 B3 00
15 01 00 00 00 00 02 B4 00
15 01 00 00 00 00 02 B5 00
15 01 00 00 00 00 02 B6 1D
15 01 00 00 00 00 02 B7 00
15 01 00 00 00 00 02 B8 51
15 01 00 00 00 00 02 B9 00
15 01 00 00 00 00 02 BA 79
15 01 00 00 00 00 02 BB 00
15 01 00 00 00 00 02 BC 97
15 01 00 00 00 00 02 BD 00
15 01 00 00 00 00 02 BE B1
15 01 00 00 00 00 02 BF 00
15 01 00 00 00 00 02 C0 C9
15 01 00 00 00 00 02 C1 00
15 01 00 00 00 00 02 C2 DD
15 01 00 00 00 00 02 C3 00
15 01 00 00 00 00 02 C4 F0
15 01 00 00 00 00 02 C5 01
15 01 00 00 00 00 02 C6 2B
15 01 00 00 00 00 02 C7 01
15 01 00 00 00 00 02 C8 58
15 01 00 00 00 00 02 C9 01
15 01 00 00 00 00 02 CA 9A
15 01 00 00 00 00 02 CB 01
15 01 00 00 00 00 02 CC CD
15 01 00 00 00 00 02 CD 02
15 01 00 00 00 00 02 CE 15
15 01 00 00 00 00 02 CF 02
15 01 00 00 00 00 02 D0 4D
15 01 00 00 00 00 02 D1 02
15 01 00 00 00 00 02 D2 4F
15 01 00 00 00 00 02 D3 02
15 01 00 00 00 00 02 D4 84
15 01 00 00 00 00 02 D5 02
15 01 00 00 00 00 02 D6 BD
15 01 00 00 00 00 02 D7 02
15 01 00 00 00 00 02 D8 E1
15 01 00 00 00 00 02 D9 03
15 01 00 00 00 00 02 DA 12
15 01 00 00 00 00 02 DB 03
15 01 00 00 00 00 02 DC 34
15 01 00 00 00 00 02 DD 03
15 01 00 00 00 00 02 DE 65
15 01 00 00 00 00 02 DF 03
15 01 00 00 00 00 02 E0 74
15 01 00 00 00 00 02 E1 03
15 01 00 00 00 00 02 E2 84
15 01 00 00 00 00 02 E3 03
15 01 00 00 00 00 02 E4 96
15 01 00 00 00 00 02 E5 03
15 01 00 00 00 00 02 E6 AA
15 01 00 00 00 00 02 E7 03
15 01 00 00 00 00 02 E8 BF
15 01 00 00 00 00 02 E9 03
15 01 00 00 00 00 02 EA D8
15 01 00 00 00 00 02 EB 03
15 01 00 00 00 00 02 EC F2
15 01 00 00 00 00 02 ED 03
15 01 00 00 00 00 02 EE FF     
15 01 00 00 00 00 02 FF 20
15 01 00 00 00 00 02 FB 01      
15 01 00 00 00 00 02 EF 00
15 01 00 00 00 00 02 F0 45
15 01 00 00 00 00 02 F1 00
15 01 00 00 00 00 02 F2 5B
15 01 00 00 00 00 02 F3 00
15 01 00 00 00 00 02 F4 85
15 01 00 00 00 00 02 F5 00
15 01 00 00 00 00 02 F6 A5
15 01 00 00 00 00 02 F7 00
15 01 00 00 00 00 02 F8 BF
15 01 00 00 00 00 02 F9 00
15 01 00 00 00 00 02 FA D6      
15 01 00 00 00 00 02 FF 21
15 01 00 00 00 00 02 FB 01
15 01 00 00 00 00 02 00 00
15 01 00 00 00 00 02 01 EA
15 01 00 00 00 00 02 02 00
15 01 00 00 00 00 02 03 FC
15 01 00 00 00 00 02 04 01
15 01 00 00 00 00 02 05 0C
15 01 00 00 00 00 02 06 01
15 01 00 00 00 00 02 07 42
15 01 00 00 00 00 02 08 01
15 01 00 00 00 00 02 09 6A
15 01 00 00 00 00 02 0A 01
15 01 00 00 00 00 02 0B A8
15 01 00 00 00 00 02 0C 01
15 01 00 00 00 00 02 0D D8
15 01 00 00 00 00 02 0E 02
15 01 00 00 00 00 02 0F 1C
15 01 00 00 00 00 02 10 02
15 01 00 00 00 00 02 11 53
15 01 00 00 00 00 02 12 02
15 01 00 00 00 00 02 13 54
15 01 00 00 00 00 02 14 02
15 01 00 00 00 00 02 15 88
15 01 00 00 00 00 02 16 02
15 01 00 00 00 00 02 17 C1
15 01 00 00 00 00 02 18 02
15 01 00 00 00 00 02 19 E4
15 01 00 00 00 00 02 1A 03
15 01 00 00 00 00 02 1B 14
15 01 00 00 00 00 02 1C 03
15 01 00 00 00 00 02 1D 36
15 01 00 00 00 00 02 1E 03
15 01 00 00 00 00 02 1F 67
15 01 00 00 00 00 02 20 03
15 01 00 00 00 00 02 21 76
15 01 00 00 00 00 02 22 03
15 01 00 00 00 00 02 23 86
15 01 00 00 00 00 02 24 03
15 01 00 00 00 00 02 25 98
15 01 00 00 00 00 02 26 03
15 01 00 00 00 00 02 27 AB
15 01 00 00 00 00 02 28 03
15 01 00 00 00 00 02 29 C1
15 01 00 00 00 00 02 2A 03
15 01 00 00 00 00 02 2B D8
15 01 00 00 00 00 02 2D 03
15 01 00 00 00 00 02 2F F2
15 01 00 00 00 00 02 30 03
15 01 00 00 00 00 02 31 FF      
15 01 00 00 00 00 02 32 00
15 01 00 00 00 00 02 33 45
15 01 00 00 00 00 02 34 00
15 01 00 00 00 00 02 35 5B
15 01 00 00 00 00 02 36 00
15 01 00 00 00 00 02 37 85
15 01 00 00 00 00 02 38 00
15 01 00 00 00 00 02 39 A5
15 01 00 00 00 00 02 3A 00
15 01 00 00 00 00 02 3B BF
15 01 00 00 00 00 02 3D 00
15 01 00 00 00 00 02 3F D6
15 01 00 00 00 00 02 40 00
15 01 00 00 00 00 02 41 EA
15 01 00 00 00 00 02 42 00
15 01 00 00 00 00 02 43 FC
15 01 00 00 00 00 02 44 01
15 01 00 00 00 00 02 45 0C
15 01 00 00 00 00 02 46 01
15 01 00 00 00 00 02 47 42
15 01 00 00 00 00 02 48 01
15 01 00 00 00 00 02 49 6A
15 01 00 00 00 00 02 4A 01
15 01 00 00 00 00 02 4B A8
15 01 00 00 00 00 02 4C 01
15 01 00 00 00 00 02 4D D8
15 01 00 00 00 00 02 4E 02
15 01 00 00 00 00 02 4F 1C
15 01 00 00 00 00 02 50 02
15 01 00 00 00 00 02 51 53
15 01 00 00 00 00 02 52 02
15 01 00 00 00 00 02 53 54
15 01 00 00 00 00 02 54 02
15 01 00 00 00 00 02 55 88
15 01 00 00 00 00 02 56 02
15 01 00 00 00 00 02 58 C1
15 01 00 00 00 00 02 59 02
15 01 00 00 00 00 02 5A E4
15 01 00 00 00 00 02 5B 03
15 01 00 00 00 00 02 5C 14
15 01 00 00 00 00 02 5D 03
15 01 00 00 00 00 02 5E 36
15 01 00 00 00 00 02 5F 03
15 01 00 00 00 00 02 60 67
15 01 00 00 00 00 02 61 03
15 01 00 00 00 00 02 62 76
15 01 00 00 00 00 02 63 03
15 01 00 00 00 00 02 64 86
15 01 00 00 00 00 02 65 03
15 01 00 00 00 00 02 66 98
15 01 00 00 00 00 02 67 03
15 01 00 00 00 00 02 68 AB
15 01 00 00 00 00 02 69 03
15 01 00 00 00 00 02 6A C1
15 01 00 00 00 00 02 6B 03
15 01 00 00 00 00 02 6C D8
15 01 00 00 00 00 02 6D 03
15 01 00 00 00 00 02 6E F2
15 01 00 00 00 00 02 6F 03
15 01 00 00 00 00 02 70 FF     
15 01 00 00 00 00 02 FF 21
15 01 00 00 00 00 02 FB 01
15 01 00 00 00 00 02 71 00
15 01 00 00 00 00 02 72 00
15 01 00 00 00 00 02 73 00
15 01 00 00 00 00 02 74 2B
15 01 00 00 00 00 02 75 00
15 01 00 00 00 00 02 76 74
15 01 00 00 00 00 02 77 00
15 01 00 00 00 00 02 78 A2
15 01 00 00 00 00 02 79 00
15 01 00 00 00 00 02 7A BD
15 01 00 00 00 00 02 7B 00
15 01 00 00 00 00 02 7C D6
15 01 00 00 00 00 02 7D 00
15 01 00 00 00 00 02 7E ED
15 01 00 00 00 00 02 7F 01   
15 01 00 00 00 00 02 80 00
15 01 00 00 00 00 02 81 01
15 01 00 00 00 00 02 82 11
15 01 00 00 00 00 02 83 01
15 01 00 00 00 00 02 84 48
15 01 00 00 00 00 02 85 01
15 01 00 00 00 00 02 86 71
15 01 00 00 00 00 02 87 01
15 01 00 00 00 00 02 88 AE
15 01 00 00 00 00 02 89 01
15 01 00 00 00 00 02 8A DD
15 01 00 00 00 00 02 8B 02
15 01 00 00 00 00 02 8C 1F
15 01 00 00 00 00 02 8D 02
15 01 00 00 00 00 02 8E 55
15 01 00 00 00 00 02 8F 02
15 01 00 00 00 00 02 90 57
15 01 00 00 00 00 02 91 02
15 01 00 00 00 00 02 92 8A
15 01 00 00 00 00 02 93 02
15 01 00 00 00 00 02 94 C2
15 01 00 00 00 00 02 95 02
15 01 00 00 00 00 02 96 E5
15 01 00 00 00 00 02 97 03
15 01 00 00 00 00 02 98 16
15 01 00 00 00 00 02 99 03
15 01 00 00 00 00 02 9A 36
15 01 00 00 00 00 02 9B 03
15 01 00 00 00 00 02 9C 64
15 01 00 00 00 00 02 9D 03
15 01 00 00 00 00 02 9E 73
15 01 00 00 00 00 02 9F 03
15 01 00 00 00 00 02 A0 83
15 01 00 00 00 00 02 A2 03
15 01 00 00 00 00 02 A3 95
15 01 00 00 00 00 02 A4 03
15 01 00 00 00 00 02 A5 A8
15 01 00 00 00 00 02 A6 03
15 01 00 00 00 00 02 A7 BE
15 01 00 00 00 00 02 A9 03
15 01 00 00 00 00 02 AA D7
15 01 00 00 00 00 02 AB 03
15 01 00 00 00 00 02 AC F1
15 01 00 00 00 00 02 AD 03
15 01 00 00 00 00 02 AE FF    
15 01 00 00 00 00 02 AF 00
15 01 00 00 00 00 02 B0 00
15 01 00 00 00 00 02 B1 00
15 01 00 00 00 00 02 B2 2B
15 01 00 00 00 00 02 B3 00
15 01 00 00 00 00 02 B4 74
15 01 00 00 00 00 02 B5 00
15 01 00 00 00 00 02 B6 A2
15 01 00 00 00 00 02 B7 00
15 01 00 00 00 00 02 B8 BD
15 01 00 00 00 00 02 B9 00
15 01 00 00 00 00 02 BA D6
15 01 00 00 00 00 02 BB 00
15 01 00 00 00 00 02 BC ED
15 01 00 00 00 00 02 BD 01
15 01 00 00 00 00 02 BE 00
15 01 00 00 00 00 02 BF 01
15 01 00 00 00 00 02 C0 11
15 01 00 00 00 00 02 C1 01
15 01 00 00 00 00 02 C2 48
15 01 00 00 00 00 02 C3 01
15 01 00 00 00 00 02 C4 71
15 01 00 00 00 00 02 C5 01
15 01 00 00 00 00 02 C6 AE
15 01 00 00 00 00 02 C7 01
15 01 00 00 00 00 02 C8 DD
15 01 00 00 00 00 02 C9 02
15 01 00 00 00 00 02 CA 1F
15 01 00 00 00 00 02 CB 02
15 01 00 00 00 00 02 CC 55
15 01 00 00 00 00 02 CD 02
15 01 00 00 00 00 02 CE 57
15 01 00 00 00 00 02 CF 02
15 01 00 00 00 00 02 D0 8A
15 01 00 00 00 00 02 D1 02
15 01 00 00 00 00 02 D2 C2
15 01 00 00 00 00 02 D3 02
15 01 00 00 00 00 02 D4 E5
15 01 00 00 00 00 02 D5 03
15 01 00 00 00 00 02 D6 16
15 01 00 00 00 00 02 D7 03
15 01 00 00 00 00 02 D8 36
15 01 00 00 00 00 02 D9 03
15 01 00 00 00 00 02 DA 64
15 01 00 00 00 00 02 DB 03
15 01 00 00 00 00 02 DC 73
15 01 00 00 00 00 02 DD 03
15 01 00 00 00 00 02 DE 83
15 01 00 00 00 00 02 DF 03
15 01 00 00 00 00 02 E0 95
15 01 00 00 00 00 02 E1 03
15 01 00 00 00 00 02 E2 A8
15 01 00 00 00 00 02 E3 03
15 01 00 00 00 00 02 E4 BE
15 01 00 00 00 00 02 E5 03
15 01 00 00 00 00 02 E6 D7
15 01 00 00 00 00 02 E7 03
15 01 00 00 00 00 02 E8 F1
15 01 00 00 00 00 02 E9 03
15 01 00 00 00 00 02 EA FF     
15 01 00 00 00 00 02 ff 10
15 01 00 00 00 00 02 36 00
15 01 00 00 00 00 02 51 ff
15 01 00 00 00 00 02 53 2c
15 01 00 00 00 00 02 55 01
15 01 00 00 00 00 02 ff 10
15 01 00 00 00 00 02 fb 01
15 01 00 00 00 00 02 35 00
29 01 00 00 00 00 03 44 09 d9
05 01 00 00 78 00 01 11               //SET DISLAY ON
05 01 00 00 20 00 01 29
		];
					/* write control brightness */
		qcom,mdss-dsi-on-command-state = "dsi_lp_mode";
		qcom,mdss-dsi-off-command = [05 01 00 00 32 00 02 28 00
					05 01 00 00 78 00 02 10 00];
		qcom,mdss-dsi-off-command-state = "dsi_hs_mode";
		//qcom,mdss-tear-check-sync-cfg-height = <2580>;
		dsi_truly_qhd_dualdsi_cmd_le_x2_config0: config0 {
		qcom,split-mode = "pingpong-split";
		};
	};
};
