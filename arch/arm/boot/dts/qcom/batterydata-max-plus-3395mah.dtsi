/* Copyright (c) 2013-2014, The Linux Foundation. All rights reserved.
 *
 * This program is free software; you can redistribute it and/or modify
 * it under the terms of the GNU General Public License version 2 and
 * only version 2 as published by the Free Software Foundation.
 *
 * This program is distributed in the hope that it will be useful,
 * but WITHOUT ANY WARRANTY; without even the implied warranty of
 * MERCHANTABILITY or FITNESS FOR A PARTICULAR PURPOSE.  See the
 * GNU General Public License for more details.
 */

qcom,mtp-3395mah {
	qcom,fcc-mah = <3400>;
	qcom,default-rbatt-mohm = <100>;
	qcom,max-voltage-uv = <4350000>;
	qcom,rbatt-capacitive-mohm = <50>;
	qcom,v-cutoff-uv = <3460000>;
	qcom,chg-term-ua = <170000>;
	qcom,batt-id-kohm = <10>;
	qcom,battery-type = "max_plus_3395mah_tmp";

	qcom,fg-profile-data = [
		 DF 83 9F 7C
		 CE 80 01 77
		 75 83 93 7C
		 AC 8B 9E 95
		 DB 81 86 99
		 C0 B6 85 C1
		 58 18 FC 83
		 15 7D FE 80
		 2C 77 7A 83
		 41 7C F3 8B
		 21 96 38 82
		 FB 98 04 B7
		 99 C2 58 15
		 4C 0D E6 5A
		 CE 6E A6 FB
		 FF 2E CD 44
		 FD 2E 00 00
		 49 4E 24 24
		 D5 48 00 00
		 00 00 00 00
		 00 00 00 00
		 0E 70 4B 70
		 D6 66 E7 89
		 67 74 4E 5B
		 29 6E 49 80
		 49 6F 00 51
		 AA 8E 69 A1
		 2B C5 5A F0
		 56 A0 71 0C
		 28 00 FF 36
		 F0 11 30 03
		 00 00 00 00
	];
};
