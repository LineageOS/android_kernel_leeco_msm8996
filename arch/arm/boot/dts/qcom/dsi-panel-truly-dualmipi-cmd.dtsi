/* Copyright (c) 2013-2014, The Linux Foundation. All rights reserved.
 *
 * This program is free software; you can redistribute it and/or modify
 * it under the terms of the GNU General Public License version 2 and
 * only version 2 as published by the Free Software Foundation.
 *
 * This program is distributed in the hope that it will be useful,
 * but WITHOUT ANY WARRANTY; without even the implied warranty of
 * MERCHANTABILITY or FITNESS FOR A PARTICULAR PURPOSE.  See the
 * GNU General Public License for more details.
 */

&mdss_mdp {
	dsi_dual_truly_cmd: qcom,mdss_dsi_truly_qhd_dualdsi_cmd {
		qcom,mdss-dsi-panel-name = "x2_mdss_dsi_truly_qhd_dualdsi_cmd";
		qcom,mdss-dsi-panel-type = "dsi_cmd_mode";
		qcom,mdss-dsi-panel-framerate = <60>;
		qcom,mdss-dsi-virtual-channel-id = <0>;
		qcom,mdss-dsi-stream = <0>;
		qcom,mdss-dsi-panel-width = <720>;
		qcom,mdss-dsi-panel-height = <2560>;
		qcom,mdss-dsi-h-front-porch = <168>;
		qcom,mdss-dsi-h-back-porch = <88>;
		qcom,mdss-dsi-h-pulse-width = <10>;
		qcom,mdss-dsi-h-sync-skew = <0>;
		qcom,mdss-dsi-v-back-porch = <10>;
		qcom,mdss-dsi-v-front-porch = <9>;
		qcom,mdss-dsi-v-pulse-width = <10>;
		qcom,mdss-dsi-h-left-border = <0>;
		qcom,mdss-dsi-h-right-border = <0>;
		qcom,mdss-dsi-v-top-border = <0>;
		qcom,mdss-dsi-v-bottom-border = <0>;
		qcom,mdss-dsi-bpp = <24>;
		qcom,mdss-dsi-color-order = "rgb_swap_rgb";
		qcom,mdss-dsi-underflow-color = <0xff>;
		qcom,mdss-dsi-border-color = <0>;
		qcom,mdss-dsi-h-sync-pulse = <0>;
		qcom,mdss-dsi-traffic-mode = "non_burst_sync_event";
		qcom,mdss-dsi-bllp-eof-power-mode;
		qcom,mdss-dsi-bllp-power-mode;
		qcom,mdss-dsi-lane-0-state;
		qcom,mdss-dsi-lane-1-state;
		qcom,mdss-dsi-lane-2-state;
		qcom,mdss-dsi-lane-3-state;
		qcom,mdss-dsi-panel-timings = [cd 32 22 00 60 64 26 34 29 03
									04 00];
		qcom,mdss-dsi-reset-sequence = <1 10>, <0 10>, <1 10>;
		qcom,mdss-dsi-t-clk-post = <0x0d>;
		qcom,mdss-dsi-t-clk-pre = <0x2d>;
		qcom,mdss-dsi-bl-max-level = <4095>;
		qcom,mdss-dsi-dma-trigger = "trigger_sw";
		qcom,mdss-dsi-mdp-trigger = "none";
		qcom,mdss-dsi-te-pin-select = <1>;
		qcom,mdss-dsi-wr-mem-start = <0x2c>;
		qcom,mdss-dsi-wr-mem-continue = <0x3c>;
		qcom,mdss-dsi-te-dcs-command = <1>;
		qcom,mdss-dsi-te-check-enable;
		qcom,mdss-dsi-te-using-te-pin;
		qcom,ulps-enabled;
		qcom,mdss-dsi-on-command = [
					23 01 00 00 00 00 02 B0 00                      //Manufacturer command access protect
					29 01 00 00 00 00 04 B3 04 00 00  		//0X04 Command Mode,  0X05 Video Mode
					29 01 00 00 00 00 04 B6 3b d3 00            //DIS control HS mode

					//Display setting common
					29 01 00 00 00 00 28
					C1 84 08 11 1F FC F2 C9 1F 5F
					98 B3 FE FF F7 FE FF D7 31 F1
					CB 3F 3F FD EF 03 24 69 18 AA
					40 01 42 02 08 00 01 00 01 00

					//Displaying setting2
					29 01 00 00 00 00 0F
					C2 01 FA 00 04 64 08 00 60 00
					38 70 00 00 00
					//Displaying setting3
					29 01 00 00 00 00 09
					C3 07 01 08 01 00 00 00 00

					//Source Timing setting
					29 01 00 00 00 00 12
					C4 70 00 00 00 02 00 00 00 00
					02 01 00 01 01 00 00 00
					//LTPS Timing setting
					29 01 00 00 00 00 11
					C6 3C 00 3C 02 37 01 0E 01 02
					01 02 03 0F 04 3C 46
					//For zoom gamma  change 151026
					29 01 00 00 00 00 1F
					C7 00 11 1C 28 37 44 4E 5B 3E
					46 52 5F 68 72 78 00 11 1C 28
					37 44 4E 5B 3E 46 52 5F 68 72 78
					//Gamma setting
					29 01 00 00 00 00 14
					C8 00 00 00 00 00 FC 00 00 00
					00 00 FC 00 00 00 00 00 FC 00
					//Digital Gamma setting
					29 01 00 00 00 00 14
					C9 00 00 00 00 00 FC 00 00 00
					00 00 FC 00 00 00 00 00 FC 00
					//Panel PIN Control
					29 01 00 00 00 00 14
					CB AA 1E E3 55 F1 FF 00 00 00
					00 00 00 00 00 00 00 00 00 00
					//Panel Interface Control
					23 01 00 00 00 00 02 CC 07
					//V black Control
					29 01 00 00 00 00 0B
					CD 3A 86 3A 86 8D 8D 04 04 00 00
					//Power Setting
					29 01 00 00 00 00 11
					D0 19 01 91 6A DC 59 19 00 00 00
					19 99 04 00 00 00
					//Power Setting for Internal Power
					29 01 00 00 00 00 21
					D3 1B 3B BB 77 77 77 BB B3 33 00
					80 A7 AF 5B 5B 33 33 33 C0 00 F2
					0F 7D 7C FF 0F 99 00 33 00 FF FF
					29 01 00 00 00 00 06 D4 57 33 07 00 F4
					//VCOM Setting
					29 01 00 00 00 00 0C
					D5 66 00 00 01 3D 01 3D 00 38 00 38
					//Sequencer Timing Control for pon
					29 01 00 00 00 00 22
					D7 04 ff 23 15 75 a4 c3 1f c3 1f d9
					07 1c 1f 30 8e 87 c7 e3 f1 cc f0 1f
					f0 0d 70 00 2A 00 7e 1d 07 00
					29 01 00 00 00 00 05 DE 00 3f ff 10
					23 01 00 00 00 00 02 D6 01  		     //NVM Load Setting(skip)

					05 01 00 00 20 00 01 29               //SET DISLAY ON
					05 01 00 00 78 00 01 11
		];
					/* write control brightness */
		qcom,mdss-dsi-on-command-state = "dsi_lp_mode";
		qcom,mdss-dsi-off-command = [05 01 00 00 32 00 02 28 00
					05 01 00 00 78 00 02 10 00];
		qcom,mdss-dsi-off-command-state = "dsi_hs_mode";
		qcom,mdss-tear-check-sync-cfg-height = <2580>;
	};
};
