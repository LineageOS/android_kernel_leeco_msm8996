/* Copyright (c) 2013, The Linux Foundation. All rights reserved.
 *
 * This program is free software; you can redistribute it and/or modify
 * it under the terms of the GNU General Public License version 2 and
 * only version 2 as published by the Free Software Foundation.
 *
 * This program is distributed in the hope that it will be useful,
 * but WITHOUT ANY WARRANTY; without even the implied warranty of
 * MERCHANTABILITY or FITNESS FOR A PARTICULAR PURPOSE.  See the
 * GNU General Public License for more details.
 */

/*---------------------------------------------------------------------------
 * This file is autogenerated file using gcdb parser. Please do not edit it.
 * Update input XML file to add a new entry or update variable in this file
 * VERSION = "1.0"
 *---------------------------------------------------------------------------*/
&mdss_mdp {
	dsi_ft8716_1080p_video: qcom,mdss_dsi_ft8716_1080p_video{
		qcom,mdss-dsi-panel-name = "mdss_dsi_ft8716_1080p_video";
		qcom,mdss-dsi-panel-type = "dsi_video_mode";
		qcom,mdss-dsi-panel-framerate = <60>;
		qcom,mdss-dsi-virtual-channel-id = <0>;
		qcom,mdss-dsi-stream = <0>;
		qcom,mdss-dsi-panel-destination = "display_1";
		qcom,mdss-dsi-panel-width = <1080>;
		qcom,mdss-dsi-panel-height = <1920>;
		qcom,mdss-dsi-h-front-porch = <36>;
		qcom,mdss-dsi-h-back-porch = <36>;
		qcom,mdss-dsi-h-pulse-width = <4>;
		qcom,mdss-dsi-h-sync-skew = <0>;
		qcom,mdss-dsi-v-back-porch = <18>;
		qcom,mdss-dsi-v-front-porch = <18>;
		qcom,mdss-dsi-v-pulse-width = <2>;
		qcom,mdss-dsi-h-left-border = <0>;
		qcom,mdss-dsi-h-right-border = <0>;
		qcom,mdss-dsi-v-top-border = <0>;
		qcom,mdss-dsi-v-bottom-border = <0>;
		qcom,mdss-dsi-bpp = <24>;
		qcom,mdss-dsi-color-order = "rgb_swap_rgb";
		qcom,mdss-dsi-underflow-color = <0xff>;
		qcom,mdss-dsi-border-color = <0>;
		qcom,mdss-dsi-h-sync-pulse = <0>;
		qcom,mdss-dsi-traffic-mode = "burst_mode";
		qcom,mdss-dsi-bllp-eof-power-mode;
		qcom,mdss-dsi-bllp-power-mode;
		qcom,mdss-dsi-lane-0-state;
		qcom,mdss-dsi-lane-1-state;
		qcom,mdss-dsi-lane-2-state;
		qcom,mdss-dsi-lane-3-state;

		qcom,mdss-dsi-panel-timings = [D6 32 22 00 62 66 26 36 28 03
									04 00];
		qcom,mdss-dsi-reset-sequence = <1 5>, <0 5>, <1 5>;
		qcom,mdss-dsi-t-clk-post = <0x04>;
		qcom,mdss-dsi-t-clk-pre = <0x2b>;
		qcom,mdss-dsi-bl-max-level = <4095>;
		qcom,mdss-brightness-max-level = <4095>;
		qcom,mdss-dsi-dma-trigger = "trigger_sw";
		qcom,mdss-dsi-mdp-trigger = "none";
		qcom,mdss-dsi-te-pin-select = <1>;
		qcom,mdss-dsi-wr-mem-start = <0x2c>;
		qcom,mdss-dsi-wr-mem-continue = <0x3c>;
		qcom,mdss-dsi-te-dcs-command = <1>;
		qcom,mdss-dsi-te-check-enable;
		qcom,mdss-dsi-te-using-te-pin;
		/*qcom,ulps-enabled;*/
 
		qcom,mdss-dsi-on-command = [05 01 00 00 78 00 01 11
					/* Set display on, wait 16ms */
					05 01 00 00 14 00 01 29
			29 01 00 00 00 00 04 FF 87 16 01
			23 01 00 00 00 00 02 00 80
			29 01 00 00 00 00 03 FF 87 16
			23 01 00 00 00 00 02 00 00
			29 01 00 00 00 00 03 99 00 00
					];
		qcom,mdss-dsi-bist-on-command = [23 01 00 00 00 00 02 00 00
			29 01 00 00 00 00 04 FF 87 16 01
			23 01 00 00 00 00 02 00 80
			29 01 00 00 00 00 03 FF 87 16
			23 01 00 00 00 00 02 00 a2
			23 01 00 00 00 00 02 C1 01
			23 01 00 00 00 00 02 00 a0
			29 01 00 00 00 00 0A F6 0F 01 23 45 67 89 AB CD EF
			23 01 00 00 00 00 02 00 A9
			23 01 00 00 00 00 02 F6 5A
			05 01 00 00 78 00 01 11
					/* Set display on, wait 16ms */
					05 01 00 00 14 00 01 29];
					/* write control brightness */
		qcom,mdss-dsi-on-command-state = "dsi_lp_mode";
		qcom,mdss-dsi-off-command = [
			29 01 00 00 00 00 04 FF 87 16 01
			23 01 00 00 00 00 02 00 80
			29 01 00 00 00 00 03 FF 87 16
			23 01 00 00 00 00 02 00 00
			29 01 00 00 00 00 03 99 95 27
					05 01 00 00 32 00 02 28 00
					05 01 00 00 78 00 02 10 00
					];
		qcom,mdss-dsi-off-command-state = "dsi_hs_mode";
		qcom,mdss-dsi-lp11-init;
		qcom,mdss-tear-check-sync-cfg-height = <2580>;
		qcom,mdss-pan-physical-width-dimension = <68>;
		qcom,mdss-pan-physical-height-dimension = <121>;
		qcom,mdss-dsi-panel-status-command = [06 01 00 01 05 00 01 0A];
		qcom,mdss-dsi-panel-status-command-mode = "dsi_lp_mode";
		qcom,mdss-dsi-panel-status-check-mode = "reg_read";
		qcom,mdss-dsi-panel-status-read-length = <1>;
		qcom,mdss-dsi-panel-status-value = <0x9C>;

		qcom,mdss-dsi-panel-status-command1 = [06 01 00 01 05 00 01 1D];
		qcom,mdss-dsi-panel-status-check-command-mode1 = "dsi_lp_mode";
		qcom,mdss-dsi-panel-status-check-mode1 = "reg_read";
		qcom,mdss-dsi-panel-status-read-length1 = <1>;
		qcom,mdss-dsi-panel-status-value1 = <0x02>;

		qcom,mdss-dsi-panel-status-on-command1 = [23 01 00 00 00 00 02 1C 02];
		qcom,mdss-dsi-status-on-command-state1 = "dsi_lp_mode";

		qcom,mdss-dsi-panel-status-command2 = [06 01 00 01 05 00 01 AC];
		qcom,mdss-dsi-panel-status-check-command-mode2 = "dsi_lp_mode";
		qcom,mdss-dsi-panel-status-check-mode2 = "reg_read";
		qcom,mdss-dsi-panel-status-read-length2 = <1>;
		qcom,mdss-dsi-panel-status-value2 = <0x00>;
		qcom,esd-check-enabled;
		/*qcom,mdss-dsi-rx-eot-ignore;*/
		/*qcom,mdss-dsi-tx-eot-append;*/
	};
};
