/* Copyright (c) 2013-2014, The Linux Foundation. All rights reserved.
 *
 * This program is free software; you can redistribute it and/or modify
 * it under the terms of the GNU General Public License version 2 and
 * only version 2 as published by the Free Software Foundation.
 *
 * This program is distributed in the hope that it will be useful,
 * but WITHOUT ANY WARRANTY; without even the implied warranty of
 * MERCHANTABILITY or FITNESS FOR A PARTICULAR PURPOSE.  See the
 * GNU General Public License for more details.
 */

&mdss_mdp {
	dsi_samsung_cmd: qcom,mdss_dsi_samsung_2k_cmd_le_turbo {
		qcom,mdss-dsi-panel-name = "le_turbo_mdss_dsi_samsung_2k_cmd";
		qcom,mdss-dsi-panel-type = "dsi_cmd_mode";
		qcom,mdss-dsi-panel-framerate = <60>;
		qcom,mdss-dsi-virtual-channel-id = <0>;
		qcom,mdss-dsi-stream = <0>;
		qcom,mdss-dsi-panel-width = <1080>;
		qcom,mdss-dsi-panel-height = <1920>;
		qcom,mdss-pan-physical-width-dimension = <68>;
		qcom,mdss-pan-physical-height-dimension = <121>;
		qcom,mdss-dsi-h-front-porch = <45>;
		qcom,mdss-dsi-h-back-porch = <45>;
		qcom,mdss-dsi-h-pulse-width = <8>;
		qcom,mdss-dsi-h-sync-skew = <0>;
		qcom,mdss-dsi-v-back-porch = <16>;
		qcom,mdss-dsi-v-front-porch = <16>;
		qcom,mdss-dsi-v-pulse-width = <4>;
		qcom,mdss-dsi-h-left-border = <0>;
		qcom,mdss-dsi-h-right-border = <0>;
		qcom,mdss-dsi-v-top-border = <0>;
		qcom,mdss-dsi-v-bottom-border = <0>;
		qcom,mdss-dsi-bpp = <24>;
		qcom,mdss-dsi-color-order = "rgb_swap_rgb";
		qcom,mdss-dsi-underflow-color = <0xff>;
		qcom,mdss-dsi-border-color = <0>;
		qcom,mdss-dsi-h-sync-pulse = <0>;
		qcom,mdss-dsi-traffic-mode = "non_burst_sync_event";
		qcom,mdss-dsi-bllp-eof-power-mode;
		qcom,mdss-dsi-bllp-power-mode;
		qcom,mdss-dsi-lane-0-state;
		qcom,mdss-dsi-lane-1-state;
		qcom,mdss-dsi-lane-2-state;
		qcom,mdss-dsi-lane-3-state;
		qcom,mdss-dsi-panel-timings = [cd 32 22 00 60 64 26 34 29 03
									04 00];
		qcom,mdss-dsi-reset-sequence = <1 10>, <0 10>, <1 10>;
		qcom,mdss-dsi-t-clk-post = <0x0c>;
		qcom,mdss-dsi-t-clk-pre = <0x2a>;
		qcom,mdss-dsi-bl-pmic-control-type = "bl_ctrl_dcs";
		qcom,mdss-dsi-dma-trigger = "trigger_sw";
		qcom,mdss-dsi-mdp-trigger = "none";
		qcom,mdss-dsi-te-pin-select = <1>;
		qcom,mdss-dsi-wr-mem-start = <0x2c>;
		qcom,mdss-dsi-wr-mem-continue = <0x3c>;
		qcom,mdss-dsi-te-check-enable;
		qcom,mdss-dsi-te-using-te-pin;
		qcom,ulps-enabled;
		qcom,mdss-dsi-on-command = [
					/* Sleep out, wait 20ms */
					05 01 00 00 14 00 01 11

					/* Common setting */
					//15 01 00 00 00 00 02 35 00 /* TE ON */
					//05 01 00 00 00 00 01 34    /* TE OFF */

					/* OSC Timing control setting */
					29 01 00 00 00 00 03 FC 5A 5A
					29 01 00 00 00 00 03 F4 00 01
					29 01 00 00 00 00 02 57 40
					29 01 00 00 00 00 03 FC A5 A5

					/* Brightness Contol (Luminance : 350nit, 7500K) */
					15 01 00 00 00 00 02 53 20 /* Dimming speed setting: 0x20 1 frame ~ 0x28 32 frames */
					//15 01 00 00 00 00 02 51 FF /* Lumiance setting: 0x04 5nit ~ 0xFF 350nit */
					//15 01 00 00 00 00 02 36 17 /* Flip panel 180 include horizonal and vertical */

					05 01 00 00 78 00 01 29 /* wait 120ms */
		];
		qcom,mdss-dsi-on-flip-chargermode-command = [
					/* Sleep out, wait 20ms */
					05 01 00 00 14 00 01 11

					/* Common setting */
					//15 01 00 00 00 00 02 35 00 /* TE ON */
					//05 01 00 00 00 00 01 34    /* TE OFF */

					/* OSC Timing control setting */
					29 01 00 00 00 00 03 FC 5A 5A
					29 01 00 00 00 00 03 F4 00 01
					29 01 00 00 00 00 02 57 40
					29 01 00 00 00 00 03 FC A5 A5

					/* Brightness Contol (Luminance : 350nit, 7500K) */
					15 01 00 00 00 00 02 53 20 /* Dimming speed setting: 0x20 1 frame ~ 0x28 32 frames */
					//15 01 00 00 00 00 02 51 FF /* Lumiance setting: 0x04 5nit ~ 0xFF 350nit */
					15 01 00 00 00 00 02 36 17 /* Flip panel 180 include horizonal and vertical */

					05 01 00 00 78 00 01 29 /* wait 120ms */
		];
					/* write control brightness */
		qcom,mdss-dsi-on-command-state = "dsi_lp_mode";
		qcom,mdss-dsi-off-command = [05 01 00 00 28 00 02 28 00
					05 01 00 00 82 00 02 10 00];
		qcom,mdss-dsi-off-command-state = "dsi_hs_mode";
	};
};
