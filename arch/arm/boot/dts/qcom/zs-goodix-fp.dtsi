&mdss_hdmi_tx {
	pinctrl-names = "hdmi_hpd_active", "hdmi_ddc_active",
				"hdmi_active", "hdmi_sleep";
	pinctrl-0 = <&mdss_hdmi_hpd_active &mdss_hdmi_ddc_suspend>;
	pinctrl-1 = <&mdss_hdmi_hpd_active &mdss_hdmi_ddc_active>;
	pinctrl-2 = <&mdss_hdmi_hpd_active &mdss_hdmi_ddc_suspend>;
	pinctrl-3 = <&mdss_hdmi_hpd_active &mdss_hdmi_ddc_active>;
	pinctrl-4 = <&mdss_hdmi_hpd_suspend &mdss_hdmi_ddc_suspend>;
};
&soc {
	spi@7579000 { /* BLSP1 QUP4 */
		compatible = "qcom,spi-qup-v2";
		#address-cells = <1>;
		#size-cells = <0>;
		reg-names = "spi_physical", "spi_bam_physical";
		reg = <0x07579000 0x600>,
		      <0x07544000 0x2b000>;
		interrupt-names = "spi_irq", "spi_bam_irq";
		interrupts = <0 95 0>, <0 238 0>;
		spi-max-frequency = <19200000>;

		goodixfp@0 {
			compatible = "goodix,fingerprint";
			reg = <0>;
			input-device-name = "gf318m";
			interrupt-parent = <&tlmm>;
			interrupts = <121 0>;
			spi-max-frequency = <1920000>;
			gfvdda-supply = <&pm8994_l21>;
			spi-qup-id = <11>;
			goodix,gpio_irq = <&tlmm 121 0x1>;
			goodix,gpio_reset = <&tlmm 31 0x0>;

			pinctrl-names = "goodix_irq","goodix_reset";
			pinctrl-0 = <&goodix_irq_active &goodix_reset_active>;
			pinctrl-1 = <&goodix_irq_suspend &goodix_reset_suspend>;
		};

        };
};

