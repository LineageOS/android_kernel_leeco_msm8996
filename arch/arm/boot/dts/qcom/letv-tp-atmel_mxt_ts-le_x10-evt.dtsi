&soc {
	i2c@75ba000 {
		atmel_mxt_ts@4a {
			compatible = "atmel,atmel_mxt_ts";
			reg = <0x4a>;
			interrupt-parent = <&tlmm>;
			interrupts = <125 0x2008>;
			avdd-supply = <&pm8994_l22>;
			vdd_io-supply = <&pm8994_l14>;
			pinctrl-names = "pmx_ts_active", "pmx_ts_suspend";
			pinctrl-0 = <&ts_active>;
			pinctrl-1 = <&ts_suspend>;
			atmel,reset-gpio = <&tlmm 89 0>;
			atmel,panel-coords = <0 0 2560 1440>;
			atmel,display-coords = <0 0 2560 1440>;
			atmel,i2c-pull-up;
			atmel,bl-addr = <0x26>;
			atmel,cfg_name = "maxtouch.cfg";
			atmel,input_name = "atmel_mxt_T100_touchscreen";
			atmel,fw_version = "16AA";
			atmel,number-of-x-lines = <28>;
			atmel,number-of-y-lines = <16>;
			atmel,rawdata_threshold_max = <27500>;
			atmel,rawdata_threshold_min = <22000>;
			atmel,rawdata_shift_value = <3700>;
			atmel,rawdata_tkey_threshold_max = <28000>;
			atmel,rawdata_tkey_threshold_min = <22000>;
			atmel,rawdata_tkey_shift_value = <4000>;
			atmel,cap-button-codes = <0x244 172 158>;
			status = "ok";
			/*atmel,cfg_1 {
				atmel,type = <0x01>;
				atmel,family-id = <0xA4>;
				atmel,variant-id = <0x02>;
				atmel,version = <0x16>;
				atmel,build = <0xAA>;
				atmel,config-year = <0x10>;
				atmel,config-month = <0x05>;
				atmel,config-date = <0x0D>;
				atmel,config = [
					00 25 00 00 00 82 00 00
					00 00 00 00 00 00 00 00
					00 00 00 00 00 00 00 00
					00 00 00 00 00 00 00 00
					00 00 00 00 00 00 00 00
					00 00 00 00 00 00 00 00
					00 00 00 00 00 00 00 00
					00 00 00 00 00 00 00 00
					00 00 00 00 00 00 00 00
					00 00 00 00 00 00 00 00
					00 00 00 00 00 00 00 00
					00 00 00 00 00 00 00 00
					00 00 00 00 00 00 00 00
					00 00 00 00 00 00 00 00
					00 00 00 00 00 00 00 00
					00 00 00 00 00 00 00 00
					00 00 00 00 00 00 00 00
					00 44 00 00 00 49 00 00
					00 00 00 00 00 00 00 00
					00 00 00 00 00 00 00 00
					00 00 00 00 00 00 00 00
					00 00 00 00 00 00 00 00
					00 00 00 00 00 00 00 00
					00 00 00 00 00 00 00 00
					00 00 00 00 00 00 00 00
					00 00 00 00 00 00 00 00
					00 00 00 00 00 00 00
					00 26 00 00 00 40 01 15
					AA 10 05 0D 00 00 00 00
					00 00 00 00 00 00 00 00
					00 00 00 00 00 00 00 00
					00 00 00 00 00 00 00 00
					00 00 00 00 00 00 00 00
					00 00 00 00 00 00 00 00
					00 00 00 00 00 00 00 00
					00 00 00 00 00 00
					00 47 00 00 00 C8 00 00
					00 00 00 00 00 00 00 00
					00 00 00 00 00 00 00 00
					00 00 00 00 00 00 00 00
					00 00 00 00 00 00 00 00
					00 00 00 00 00 00 00 00
					00 00 00 00 00 00 00 00
					00 00 00 00 00 00 00 00
					00 00 00 00 00 00 00 00
					00 00 00 00 00 00 00 00
					00 00 00 00 00 00 00 00
					00 00 00 00 00 00 00 00
					00 00 00 00 00 00 00 00
					00 00 00 00 00 00 00 00
					00 00 00 00 00 00 00 00
					00 00 00 00 00 00 00 00
					00 00 00 00 00 00 00 00
					00 00 00 00 00 00 00 00
					00 00 00 00 00 00 00 00
					00 00 00 00 00 00 00 00
					00 00 00 00 00 00 00 00
					00 00 00 00 00 00 00 00
					00 00 00 00 00 00 00 00
					00 00 00 00 00 00 00 00
					00 00 00 00 00 00 00 00
					00 00 00 00 00 00
					00 6E 00 00 00 28 C9 00
					29 01 79 01 89 01 09 01
					49 01 01 02 B9 01 89 01
					61 01 91 00 39 01 89 01
					89 01 09 02 11 00 01 00
					01 00 01 00 01 00
					00 6E 00 01 00 28 01 00
					C1 00 C9 01 89 01 A9 00
					09 00 49 00 09 00 49 01
					41 00 B9 01 79 01 A1 01
					D9 00 F9 00 01 00 01 00
					01 00 01 00 01 00
					00 6E 00 02 00 28 01 00
					09 04 B9 04 29 04 89 04
					69 03 11 03 A9 01 31 05
					01 00 B9 04 71 04 89 04
					21 04 E1 01 01 00 01 00
					01 00 01 00 01 00
					00 6E 00 03 00 28 C9 00
					29 01 79 01 89 01 09 01
					49 01 01 02 B9 01 89 01
					61 01 91 00 39 01 89 01
					89 01 09 02 11 00 01 00
					01 00 01 00 01 00
					00 6E 00 04 00 28 01 00
					C1 00 C9 01 89 01 A9 00
					09 00 49 00 09 00 49 01
					41 00 B9 01 79 01 A1 01
					D9 00 F9 00 01 00 01 00
					01 00 01 00 01 00
					00 6E 00 05 00 28 01 00
					09 04 B9 04 29 04 89 04
					69 03 11 03 A9 01 31 05
					01 00 B9 04 71 04 89 04
					21 04 E1 01 01 00 01 00
					01 00 01 00 01 00
					00 6E 00 06 00 28 CB 0F
					CB 0F CB 0F CB 0F CB 0F
					CB 0F CB 0F CB 0F CB 0F
					CB 0F CB 0F CB 0F CB 0F
					CB 0F CB 0F CB 0F 03 00
					03 00 03 00 03 00
					00 6E 00 07 00 28 03 00
					3B 01 2B 01 2B 01 3B 01
					3B 01 3B 01 3B 01 2B 01
					33 01 23 01 2B 01 2B 01
					33 01 33 01 03 00 03 00
					03 00 03 00 03 00
					00 6E 00 08 00 28 03 00
					33 01 33 01 33 01 33 01
					3B 01 3B 01 4B 01 23 01
					53 01 2B 01 2B 01 2B 01
					33 01 4B 01 03 00 03 00
					03 00 03 00 03 00
					00 07 00 00 00 05 FF FF
					14 42 00
					00 08 00 00 00 0F 28 00
					0A 05 00 00 00 00 00 00
					0B 01 01 01 80
					00 0F 00 00 00 0B 8B 1C
					10 01 03 00 07 32 02 0A
					00
					00 12 00 00 00 02 00 00
					00 13 00 00 00 06 03 00
					00 3F 00 00
					00 19 00 00 00 10 02 00
					90 65 F0 55 48 71 20 4E
					28 A0 0F 88 13 00
					00 28 00 00 00 05 11 00
					00 0F 0F
					00 2A 00 00 00 0D 21 00
					FF 32 82 00 00 0A 05 00
					00 01 00
					00 2B 00 00 00 12 00 00
					00 00 00 00 00 00 00 00
					00 00 00 00 00 00 00 08
					00 2E 00 00 00 0C 00 00
					08 10 00 00 00 00 00 00
					00 00
					00 2F 00 00 00 28 00 00
					00 00 00 00 00 00 00 00
					00 00 00 00 00 00 00 00
					00 00 00 00 00 00 00 00
					00 00 00 00 00 00 00 00
					00 00 00 00 00 00
					00 38 00 00 00 24 00 00
					01 20 02 02 02 02 02 02
					02 02 02 02 02 02 02 02
					02 02 02 02 02 02 02 02
					02 02 02 02 02 02 00 00
					00 00
					00 3D 00 00 00 05 00 00
					00 00 00
					00 3D 00 01 00 05 00 00
					00 00 00
					00 3D 00 02 00 05 00 00
					00 00 00
					00 3D 00 03 00 05 00 00
					00 00 00
					00 3D 00 04 00 05 00 00
					00 00 00
					00 3D 00 05 00 05 00 00
					00 00 00
					00 41 00 00 00 17 81 03
					00 00 00 00 00 00 00 00
					05 00 00 00 00 00 00 21
					00 00 00 00 00
					00 41 00 01 00 17 00 00
					00 00 00 00 00 00 00 00
					00 00 00 00 00 00 00 00
					00 00 00 00 00
					00 41 00 02 00 17 00 00
					00 00 00 00 00 00 00 00
					00 00 00 00 00 00 00 00
					00 00 00 00 00
					00 46 00 00 00 0A 00 00
					00 00 00 00 00 00 00 00
					00 46 00 01 00 0A 00 00
					00 00 00 00 00 00 00 00
					00 46 00 02 00 0A 00 00
					00 00 00 00 00 00 00 00
					00 46 00 03 00 0A 00 00
					00 00 00 00 00 00 00 00
					00 46 00 04 00 0A 00 00
					00 00 00 00 00 00 00 00
					00 46 00 05 00 0A 00 00
					00 00 00 00 00 00 00 00
					00 46 00 06 00 0A 00 00
					00 00 00 00 00 00 00 00
					00 46 00 07 00 0A 00 00
					00 00 00 00 00 00 00 00
					00 46 00 08 00 0A 00 00
					00 00 00 00 00 00 00 00
					00 46 00 09 00 0A 00 00
					00 00 00 00 00 00 00 00
					00 46 00 0A 00 0A 00 00
					00 00 00 00 00 00 00 00
					00 46 00 0B 00 0A 00 00
					00 00 00 00 00 00 00 00
					00 46 00 0C 00 0A 00 00
					00 00 00 00 00 00 00 00
					00 46 00 0D 00 0A 00 00
					00 00 00 00 00 00 00 00
					00 46 00 0E 00 0A 00 00
					00 00 00 00 00 00 00 00
					00 46 00 0F 00 0A 00 00
					00 00 00 00 00 00 00 00
					00 46 00 10 00 0A 00 00
					00 00 00 00 00 00 00 00
					00 46 00 11 00 0A 00 00
					00 00 00 00 00 00 00 00
					00 46 00 12 00 0A 00 00
					00 00 00 00 00 00 00 00
					00 46 00 13 00 0A 00 00
					00 00 00 00 00 00 00 00
					00 48 00 00 00 55 FD 00
					00 01 00 05 0A 0A 00 05
					0C 14 02 04 20 50 0D 0A
					36 05 00 00 20 51 5C 86
					10 10 10 10 10 20 20 20
					20 20 00 00 10 00 01 00
					20 51 5C 86 20 20 20 20
					20 20 20 20 20 20 00 04
					1C 22 09 00 20 51 5C 86
					30 30 30 30 30 30 30 30
					30 30 00 06 00 33 00 03
					08 02 02
					00 4D 00 00 00 02 00 00
					00 4E 00 00 00 0C 84 05
					05 0A 14 02 18 00 00 0E
					03 09
					00 4F 00 00 00 04 00 00
					00 00
					00 4F 00 01 00 04 00 00
					00 00
					00 4F 00 02 00 04 00 00
					00 00
					00 50 00 00 00 0C 01 01
					B4 64 14 C5 00 96 01 00
					00 00
					00 51 00 00 00 12 00 00
					00 00 00 00 00 00 00 00
					00 00 00 00 00 00 00 00
					00 51 00 01 00 12 00 00
					00 00 00 00 00 00 00 00
					00 00 00 00 00 00 00 00
					00 54 00 00 00 04 00 00
					00 00
					00 5D 00 00 00 1E 00 00
					00 00 00 00 00 00 00 00
					00 00 00 00 00 00 00 00
					00 00 00 00 00 00 00 00
					00 00 00 00
					00 63 00 00 00 0C 00 00
					00 00 00 00 00 00 00 00
					00 00
					00 64 00 00 00 3C 83 F6
					01 00 00 00 0A 88 00 1C
					2D 03 03 FF 09 23 1A 00
					00 00 10 2D 06 06 9F 05
					22 2E 0A 05 37 12 23 00
					5A 0A 32 05 00 01 01 00
					00 0A 02 FA 01 28 00 02
					00 C8 C8 06 A0 1B 00 00
					A4 2F
					00 65 00 00 00 1E 00 00
					00 00 00 00 00 00 00 00
					00 00 00 00 00 00 00 00
					00 00 00 00 00 00 00 00
					00 00 00 00
					00 68 00 00 00 0B 01 11
					32 0A 0F 02 12 32 0A 0F
					02
					00 6C 00 00 00 4B 00 00
					00 00 45 0A 00 00 06 03
					00 00 00 00 1C 38 54 00
					70 28 28 20 30 20 28 28
					20 30 20 00 00 B4 00 01
					1C 38 54 00 70 40 38 30
					40 30 40 38 30 40 30 00
					96 C8 33 00 1C 38 54 00
					70 50 48 40 58 38 50 48
					40 58 38 00 AA 00 33 00
					00
					00 6D 00 00 00 09 02 00
					05 00 00 00 00 00 00
					00 6F 00 00 00 17 08 07
					32 2D 10 10 08 01 00 0A
					0C 00 00 00 00 00 00 00
					00 00 00 0A 00
					00 6F 00 01 00 17 00 00
					00 00 00 00 00 00 00 00
					00 00 00 00 00 00 00 00
					00 00 00 00 00
					00 6F 00 02 00 17 08 00
					32 2D 40 40 28 03 00 1E
					0C 00 00 00 00 00 00 00
					00 00 00 00 00
					00 70 00 00 00 05 00 00
					00 00 00
					00 70 00 01 00 05 00 00
					00 00 00
					00 71 00 00 00 03 01 07
					00
					00 73 00 00 00 14 00 00
					00 00 00 00 00 00 00 00
					00 00 00 00 00 00 00 00
					00 00
					00 74 00 00 00 FF 00 00
					00 00 00 00 00 00 00 00
					00 00 00 00 00 00 00 00
					00 00 00 00 00 00 00 00
					00 00 00 00 00 00 00 00
					00 00 00 00 00 00 00 00
					00 00 00 00 00 00 00 00
					00 00 00 00 00 00 00 00
					00 00 00 00 00 00 00 00
					00 00 00 00 00 00 00 00
					00 00 00 00 00 00 00 00
					00 00 00 00 00 00 00 00
					00 00 00 00 00 00 00 00
					00 00 00 00 00 00 00 00
					00 00 00 00 00 00 00 00
					00 00 00 00 00 00 00 00
					00 00 00 00 00 00 00 00
					00 00 00 00 00 00 00 00
					00 00 00 00 00 00 00 00
					00 00 00 00 00 00 00 00
					00 00 00 00 00 00 00 00
					00 00 00 00 00 00 00 00
					00 00 00 00 00 00 00 00
					00 00 00 00 00 00 00 00
					00 00 00 00 00 00 00 00
					00 00 00 00 00 00 00 00
					00 00 00 00 00 00 00 00
					00 00 00 00 00 00 00 00
					00 00 00 00 00 00 00 00
					00 00 00 00 00 00 00 00
					00 00 00 00 00 00 00 00
					00 00 00 00 00 00 00 00
					00 00 00 00 00
					00 79 00 00 00 03 00 00
					00
				];
			};
			atmel,cfg_2 {
				atmel,type = <0x01>;
				atmel,family-id = <0xA4>;
				atmel,variant-id = <0x02>;
				atmel,version = <0x16>;
				atmel,build = <0xAA>;
				atmel,config-year = <0x10>;
				atmel,config-month = <0x05>;
				atmel,config-date = <0x0D>;
				atmel,config = [
					00 25 00 00 00 82 00 00
					00 00 00 00 00 00 00 00
					00 00 00 00 00 00 00 00
					00 00 00 00 00 00 00 00
					00 00 00 00 00 00 00 00
					00 00 00 00 00 00 00 00
					00 00 00 00 00 00 00 00
					00 00 00 00 00 00 00 00
					00 00 00 00 00 00 00 00
					00 00 00 00 00 00 00 00
					00 00 00 00 00 00 00 00
					00 00 00 00 00 00 00 00
					00 00 00 00 00 00 00 00
					00 00 00 00 00 00 00 00
					00 00 00 00 00 00 00 00
					00 00 00 00 00 00 00 00
					00 00 00 00 00 00 00 00
					00 44 00 00 00 49 00 00
					00 00 00 00 00 00 00 00
					00 00 00 00 00 00 00 00
					00 00 00 00 00 00 00 00
					00 00 00 00 00 00 00 00
					00 00 00 00 00 00 00 00
					00 00 00 00 00 00 00 00
					00 00 00 00 00 00 00 00
					00 00 00 00 00 00 00 00
					00 00 00 00 00 00 00
					00 26 00 00 00 40 01 15
					AA 10 05 0D 00 00 00 00
					00 00 00 00 00 00 00 00
					00 00 00 00 00 00 00 00
					00 00 00 00 00 00 00 00
					00 00 00 00 00 00 00 00
					00 00 00 00 00 00 00 00
					00 00 00 00 00 00 00 00
					00 00 00 00 00 00
					00 47 00 00 00 C8 00 00
					00 00 00 00 00 00 00 00
					00 00 00 00 00 00 00 00
					00 00 00 00 00 00 00 00
					00 00 00 00 00 00 00 00
					00 00 00 00 00 00 00 00
					00 00 00 00 00 00 00 00
					00 00 00 00 00 00 00 00
					00 00 00 00 00 00 00 00
					00 00 00 00 00 00 00 00
					00 00 00 00 00 00 00 00
					00 00 00 00 00 00 00 00
					00 00 00 00 00 00 00 00
					00 00 00 00 00 00 00 00
					00 00 00 00 00 00 00 00
					00 00 00 00 00 00 00 00
					00 00 00 00 00 00 00 00
					00 00 00 00 00 00 00 00
					00 00 00 00 00 00 00 00
					00 00 00 00 00 00 00 00
					00 00 00 00 00 00 00 00
					00 00 00 00 00 00 00 00
					00 00 00 00 00 00 00 00
					00 00 00 00 00 00 00 00
					00 00 00 00 00 00 00 00
					00 00 00 00 00 00
					00 6E 00 00 00 28 C9 00
					29 01 79 01 89 01 09 01
					49 01 01 02 B9 01 89 01
					61 01 91 00 39 01 89 01
					89 01 09 02 11 00 01 00
					01 00 01 00 01 00
					00 6E 00 01 00 28 01 00
					C1 00 C9 01 89 01 A9 00
					09 00 49 00 09 00 49 01
					41 00 B9 01 79 01 A1 01
					D9 00 F9 00 01 00 01 00
					01 00 01 00 01 00
					00 6E 00 02 00 28 01 00
					09 04 B9 04 29 04 89 04
					69 03 11 03 A9 01 31 05
					01 00 B9 04 71 04 89 04
					21 04 E1 01 01 00 01 00
					01 00 01 00 01 00
					00 6E 00 03 00 28 C9 00
					29 01 79 01 89 01 09 01
					49 01 01 02 B9 01 89 01
					61 01 91 00 39 01 89 01
					89 01 09 02 11 00 01 00
					01 00 01 00 01 00
					00 6E 00 04 00 28 01 00
					C1 00 C9 01 89 01 A9 00
					09 00 49 00 09 00 49 01
					41 00 B9 01 79 01 A1 01
					D9 00 F9 00 01 00 01 00
					01 00 01 00 01 00
					00 6E 00 05 00 28 01 00
					09 04 B9 04 29 04 89 04
					69 03 11 03 A9 01 31 05
					01 00 B9 04 71 04 89 04
					21 04 E1 01 01 00 01 00
					01 00 01 00 01 00
					00 6E 00 06 00 28 CB 0F
					CB 0F CB 0F CB 0F CB 0F
					CB 0F CB 0F CB 0F CB 0F
					CB 0F CB 0F CB 0F CB 0F
					CB 0F CB 0F CB 0F 03 00
					03 00 03 00 03 00
					00 6E 00 07 00 28 03 00
					3B 01 2B 01 2B 01 3B 01
					3B 01 3B 01 3B 01 2B 01
					33 01 23 01 2B 01 2B 01
					33 01 33 01 03 00 03 00
					03 00 03 00 03 00
					00 6E 00 08 00 28 03 00
					33 01 33 01 33 01 33 01
					3B 01 3B 01 4B 01 23 01
					53 01 2B 01 2B 01 2B 01
					33 01 4B 01 03 00 03 00
					03 00 03 00 03 00
					00 07 00 00 00 05 FF FF
					14 42 00
					00 08 00 00 00 0F 28 00
					0A 05 00 00 00 00 00 00
					0B 01 01 01 80
					00 0F 00 00 00 0B 8B 1C
					10 01 03 00 07 32 02 0A
					00
					00 12 00 00 00 02 00 00
					00 13 00 00 00 06 03 00
					00 3F 00 00
					00 19 00 00 00 10 02 00
					90 65 F0 55 48 71 20 4E
					28 A0 0F 88 13 00
					00 28 00 00 00 05 11 00
					00 0F 0F
					00 2A 00 00 00 0D 21 00
					FF 32 82 00 00 0A 05 00
					00 01 00
					00 2B 00 00 00 12 00 00
					00 00 00 00 00 00 00 00
					00 00 00 00 00 00 00 08
					00 2E 00 00 00 0C 00 00
					08 10 00 00 00 00 00 00
					00 00
					00 2F 00 00 00 28 00 00
					00 00 00 00 00 00 00 00
					00 00 00 00 00 00 00 00
					00 00 00 00 00 00 00 00
					00 00 00 00 00 00 00 00
					00 00 00 00 00 00
					00 38 00 00 00 24 00 00
					01 20 02 02 02 02 02 02
					02 02 02 02 02 02 02 02
					02 02 02 02 02 02 02 02
					02 02 02 02 02 02 00 00
					00 00
					00 3D 00 00 00 05 00 00
					00 00 00
					00 3D 00 01 00 05 00 00
					00 00 00
					00 3D 00 02 00 05 00 00
					00 00 00
					00 3D 00 03 00 05 00 00
					00 00 00
					00 3D 00 04 00 05 00 00
					00 00 00
					00 3D 00 05 00 05 00 00
					00 00 00
					00 41 00 00 00 17 81 03
					00 00 00 00 00 00 00 00
					05 00 00 00 00 00 00 21
					00 00 00 00 00
					00 41 00 01 00 17 00 00
					00 00 00 00 00 00 00 00
					00 00 00 00 00 00 00 00
					00 00 00 00 00
					00 41 00 02 00 17 00 00
					00 00 00 00 00 00 00 00
					00 00 00 00 00 00 00 00
					00 00 00 00 00
					00 46 00 00 00 0A 00 00
					00 00 00 00 00 00 00 00
					00 46 00 01 00 0A 00 00
					00 00 00 00 00 00 00 00
					00 46 00 02 00 0A 00 00
					00 00 00 00 00 00 00 00
					00 46 00 03 00 0A 00 00
					00 00 00 00 00 00 00 00
					00 46 00 04 00 0A 00 00
					00 00 00 00 00 00 00 00
					00 46 00 05 00 0A 00 00
					00 00 00 00 00 00 00 00
					00 46 00 06 00 0A 00 00
					00 00 00 00 00 00 00 00
					00 46 00 07 00 0A 00 00
					00 00 00 00 00 00 00 00
					00 46 00 08 00 0A 00 00
					00 00 00 00 00 00 00 00
					00 46 00 09 00 0A 00 00
					00 00 00 00 00 00 00 00
					00 46 00 0A 00 0A 00 00
					00 00 00 00 00 00 00 00
					00 46 00 0B 00 0A 00 00
					00 00 00 00 00 00 00 00
					00 46 00 0C 00 0A 00 00
					00 00 00 00 00 00 00 00
					00 46 00 0D 00 0A 00 00
					00 00 00 00 00 00 00 00
					00 46 00 0E 00 0A 00 00
					00 00 00 00 00 00 00 00
					00 46 00 0F 00 0A 00 00
					00 00 00 00 00 00 00 00
					00 46 00 10 00 0A 00 00
					00 00 00 00 00 00 00 00
					00 46 00 11 00 0A 00 00
					00 00 00 00 00 00 00 00
					00 46 00 12 00 0A 00 00
					00 00 00 00 00 00 00 00
					00 46 00 13 00 0A 00 00
					00 00 00 00 00 00 00 00
					00 48 00 00 00 55 FD 00
					00 01 00 05 0A 0A 00 05
					0C 14 02 04 20 50 0D 0A
					36 05 00 00 20 51 5C 86
					10 10 10 10 10 20 20 20
					20 20 00 00 10 00 01 00
					20 51 5C 86 20 20 20 20
					20 20 20 20 20 20 00 04
					1C 22 09 00 20 51 5C 86
					30 30 30 30 30 30 30 30
					30 30 00 06 00 33 00 03
					08 02 02
					00 4D 00 00 00 02 00 00
					00 4E 00 00 00 0C 84 05
					05 0A 14 02 18 00 00 0E
					03 09
					00 4F 00 00 00 04 00 00
					00 00
					00 4F 00 01 00 04 00 00
					00 00
					00 4F 00 02 00 04 00 00
					00 00
					00 50 00 00 00 0C 01 01
					B4 64 14 C5 00 96 01 00
					00 00
					00 51 00 00 00 12 00 00
					00 00 00 00 00 00 00 00
					00 00 00 00 00 00 00 00
					00 51 00 01 00 12 00 00
					00 00 00 00 00 00 00 00
					00 00 00 00 00 00 00 00
					00 54 00 00 00 04 00 00
					00 00
					00 5D 00 00 00 1E 00 00
					00 00 00 00 00 00 00 00
					00 00 00 00 00 00 00 00
					00 00 00 00 00 00 00 00
					00 00 00 00
					00 63 00 00 00 0C 00 00
					00 00 00 00 00 00 00 00
					00 00
					00 64 00 00 00 3C 83 F6
					01 00 00 00 0A 88 00 1C
					2D 03 03 FF 09 23 1A 00
					00 00 10 2D 06 06 9F 05
					22 2E 0A 05 37 12 23 00
					5A 0A 32 05 00 01 01 00
					00 0A 02 FA 01 28 00 02
					00 C8 C8 06 A0 1B 00 00
					A4 2F
					00 65 00 00 00 1E 00 00
					00 00 00 00 00 00 00 00
					00 00 00 00 00 00 00 00
					00 00 00 00 00 00 00 00
					00 00 00 00
					00 68 00 00 00 0B 01 11
					32 0A 0F 02 12 32 0A 0F
					02
					00 6C 00 00 00 4B 00 00
					00 00 45 0A 00 00 06 03
					00 00 00 00 1C 38 54 00
					70 28 28 20 30 20 28 28
					20 30 20 00 00 B4 00 01
					1C 38 54 00 70 40 38 30
					40 30 40 38 30 40 30 00
					96 C8 33 00 1C 38 54 00
					70 50 48 40 58 38 50 48
					40 58 38 00 AA 00 33 00
					00
					00 6D 00 00 00 09 02 00
					05 00 00 00 00 00 00
					00 6F 00 00 00 17 08 07
					32 2D 10 10 08 01 00 0A
					0C 00 00 00 00 00 00 00
					00 00 00 0A 00
					00 6F 00 01 00 17 00 00
					00 00 00 00 00 00 00 00
					00 00 00 00 00 00 00 00
					00 00 00 00 00
					00 6F 00 02 00 17 08 00
					32 2D 40 40 28 03 00 1E
					0C 00 00 00 00 00 00 00
					00 00 00 00 00
					00 70 00 00 00 05 00 00
					00 00 00
					00 70 00 01 00 05 00 00
					00 00 00
					00 71 00 00 00 03 01 07
					00
					00 73 00 00 00 14 00 00
					00 00 00 00 00 00 00 00
					00 00 00 00 00 00 00 00
					00 00
					00 74 00 00 00 FF 00 00
					00 00 00 00 00 00 00 00
					00 00 00 00 00 00 00 00
					00 00 00 00 00 00 00 00
					00 00 00 00 00 00 00 00
					00 00 00 00 00 00 00 00
					00 00 00 00 00 00 00 00
					00 00 00 00 00 00 00 00
					00 00 00 00 00 00 00 00
					00 00 00 00 00 00 00 00
					00 00 00 00 00 00 00 00
					00 00 00 00 00 00 00 00
					00 00 00 00 00 00 00 00
					00 00 00 00 00 00 00 00
					00 00 00 00 00 00 00 00
					00 00 00 00 00 00 00 00
					00 00 00 00 00 00 00 00
					00 00 00 00 00 00 00 00
					00 00 00 00 00 00 00 00
					00 00 00 00 00 00 00 00
					00 00 00 00 00 00 00 00
					00 00 00 00 00 00 00 00
					00 00 00 00 00 00 00 00
					00 00 00 00 00 00 00 00
					00 00 00 00 00 00 00 00
					00 00 00 00 00 00 00 00
					00 00 00 00 00 00 00 00
					00 00 00 00 00 00 00 00
					00 00 00 00 00 00 00 00
					00 00 00 00 00 00 00 00
					00 00 00 00 00 00 00 00
					00 00 00 00 00 00 00 00
					00 00 00 00 00
					00 79 00 00 00 03 00 00
					00
				];
			};*/
		};
	};
};
