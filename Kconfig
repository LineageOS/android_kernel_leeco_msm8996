## Kconfig
```kconfig
#
# For a description of the syntax of this configuration file,
# see Documentation/kbuild/kconfig-language.txt.
#
mainmenu "Linux/$ARCH $KERNELVERSION Kernel Configuration"

config SRCARCH
	string
	option env="SRCARCH"

config VENDOR_LEECO
	bool "LeEco support"
	help
	  This feature enables LeEco specific hacks

source "arch/$SRCARCH/Kconfig"
```

## arch/arm64/leeco/Kconfig
```kconfig
config MACH_LEECO
	bool
	depends on ARCH_MSM

config MACH_LEECO_MSM8996
	depends on ARCH_MSM8996
	select MACH_LEECO
	bool "LeEco MSM8996 Platform"
	help
	  Support for LeEco MSM8996 device variants.

menu "LeEco board selection"

config MACH_MAX_PLUS
	select MACH_LEECO_MSM8996
	bool "Max-Plus"
	help
	  Support for the Max-Plus variant

config MACH_X10
	select MACH_LEECO_MSM8996
	bool "x10"
	help
	  Support for the x10 variant

config MACH_X2
	select MACH_LEECO_MSM8996
	bool "x2"
	help
	  Support for the x2 variant

config MACH_X5
	select MACH_LEECO_MSM8996
	bool "x5"
	help
	  Support for the x5 variant

config MACH_X51
	select MACH_LEECO_MSM8996
	bool "x51"
	help
	  Support for the x51 variant

config MACH_TURBO
	select MACH_LEECO_MSM8996
	bool "turbo"
	help
	  Support for the turbo variant

config MACH_ZL1
	select MACH_LEECO_MSM8996
	select SND_SOC_WCD_MBHC_ZL1
	select SND_SOC_MAX98927
	bool "zl1"
	help
	  Support for the zl1 variant

endmenu
```

## drivers/clk/msm/Kconfig
```kconfig
config MSM_CLK_CONTROLLER_V2
	bool "QTI clock driver"
	---help---
	   Generate clock data structures from definitions found in
	   device tree.

config PVS_LEVEL_INTERFACE
	bool "Expose PVS level information in sys fs (Boeffla-Kernel)"
	help
		Allow PVS level to be shown in Boeffla-Config app

source "drivers/clk/msm/mdss/Kconfig"
```

## drivers/input/fpc1020/Kconfig
```kconfig
config INPUT_FPC1020
	tristate "fpc1020 driver support"
	help
	  Say Y here if you want to support pfc1020 etc...
```

## drivers/input/goodixfp/Kconfig
```kconfig
#
# Goodix fingerprint sensor
#
config INPUT_GP5XX8
	tristate "Goodix GP5XX8 driver support"
	depends on INPUT
	help
	  Say Y here if you want to support Goodix 5208
	  fingerprint sensor.

	  If unsure, say N.
```

## drivers/input/touchscreen/hideep_letv/Kconfig
```kconfig
config TOUCHSCREEN_HIDEEP_TP_LETV
	default N
	tristate "Hideep Touchpannel for debug"
	depends on I2C
	---help---
	  say Y to enable driver for hideep Touchpanel.
```

## drivers/nfc/pn544_oem/Kconfig
```kconfig
config NFC_PN544_OEM
	tristate "Qualcomm NCI based NFC Controller Driver for NQx"
	depends on I2C
    default n
	---help---
	  This enables the NFC driver for NQx based devices.
	  This is for i2c connected version. NCI protocol logic
	  resides in the usermode and it has no other NFC dependencies.
```

## drivers/staging/product_config/Kconfig
```kconfig
config SND_SOC_WCD_MBHC_ZL1
	bool "ZL1 specific wcd-mbhc-v2-zl1.c used"
	help
	  Selects ZL1 specific wcd-mbhc-v2-zl1.c file instead of default wcd-mbhc-v2.c

config PRODUCT_LE_X2
	bool "Product set to LE X2"
	default n
	---help---
	  This option is meant to be selected automatically by AndroidKernel.mk.
	  Once selected, X2 specific configs/code will take effect.

config PRODUCT_LE_ZL1
	bool "Product set to LE ZL1"
	select SND_SOC_WCD_MBHC_ZL1
	select SND_SOC_MAX98927
	default n
	---help---
	  This option is meant to be selected automatically by AndroidKernel.mk.
	  Once selected, ZL1 specific configs/code will take effect.
```

## drivers/video/msm/mdss/dp/Kconfig
```kconfig
config FB_MSM_MDSS_HDMI_DP_ANX7816
	tristate "Analogix Slimport transmitter COLORADO3 support"
	help
        	Slimport Transmitter is a HD video transmitter chip
		over micro-USB connector for smartphone device.
```

## drivers/zes_util/Kconfig
```kconfig
config ZES_POWER_DEBUG
        bool "Enable ZES POWER DEBUG"
        ---help---
          Allows to enable power debug feature
```
